## conf/machine/jetson-nano-2gb-devkit.conf
```bitbake
#@TYPE: Machine
#@NAME: Nvidia Jetson Nano 2GB Dev Kit
#@DESCRIPTION: Nvidia Jetson Nano 2GB development kit

KERNEL_ARGS ?= "console=ttyS0,115200 console=tty0 fbcon=map:0 net.ifnames=0"
IMAGE_ROOTFS_ALIGNMENT ?= "1024"

NVPMODEL ?= "nvpmodel_t210_jetson-nano"

TEGRA_BOARDID ?= "3448"
TEGRA_FAB ?= "400"
TEGRA_BOARDSKU ?= "0003"
TEGRA_BUPGEN_SPECS ?= "fab=300;boardsku=0003"

require conf/machine/include/tegra210.inc

KERNEL_ROOTSPEC_DEFAULT = "root=/dev/mmcblk0p${distro_bootpart} rw rootwait"
MACHINE_EXTRA_RRECOMMENDS += "kernel-module-rtl8821cu"

KERNEL_DEVICETREE ?= "tegra210-p3448-0003-p3542-0000.dtb"

UBOOT_MACHINE = "p3541-0000_defconfig"

EMMC_SIZE ?= ""
EMMC_DEVSECT_SIZE ?= "512"
BOOTPART_SIZE ?= ""
BOOTPART_LIMIT ?= "10485760"
ROOTFSPART_SIZE ?= "15032385536"
ODMDATA ?= "0xA4000"
EMMC_BCT ?= "P3448_A00_lpddr4_204Mhz_P987.cfg"
NVIDIA_BOARD ?= "t210ref"
NVIDIA_BOARD_CFG ?= ""
PARTITION_LAYOUT_TEMPLATE ?= "flash_l4t_t210_max-spi_sd_p3448.xml"
TEGRA_SPIFLASH_BOOT ?= "1"
TEGRAFLASH_SDCARD_SIZE ?= "16G"
OTABOOTDEV ?= "/dev/mtdblock0"
OTAGPTDEV ?= "/dev/mtdblock0"
BOOT_PARTITIONS_ON_EMMC = "0"
```

## conf/machine/jetson-nano-devkit-emmc.conf
```bitbake
#@TYPE: Machine
#@NAME: Nvidia Jetson Nano (eMMC)
#@DESCRIPTION: Nvidia Jetson Nano dev board with eMMC module

KERNEL_ARGS ?= "console=ttyS0,115200 console=tty0 fbcon=map:0 net.ifnames=0 sdhci_tegra.en_boot_part_access=1"
IMAGE_ROOTFS_ALIGNMENT ?= "1024"

NVPMODEL ?= "nvpmodel_t210_jetson-nano"

TEGRA_BOARDID ?= "3448"
TEGRA_FAB ?= "400"
TEGRA_BOARDSKU ?= "0002"
# Extracted from l4t_generate_soc_bup.sh for BOARDID=3448 and board=jetson-nano-devkit-emmc
TEGRA_BUPGEN_SPECS ?= "fab=200;boardsku=0002 \
		       fab=300;boardsku=0002"

require conf/machine/include/tegra210.inc

KERNEL_DEVICETREE ?= "tegra210-p3448-0002-p3449-0000-a02.dtb \
 		      tegra210-p3448-0002-p3449-0000-b00.dtb \
"

UBOOT_MACHINE = "p3450-0002_defconfig"

EMMC_SIZE ?= "15758000128"
EMMC_DEVSECT_SIZE ?= "512"
BOOTPART_SIZE ?= ""
BOOTPART_LIMIT ?= "10485760"
ROOTFSPART_SIZE ?= "15032385536"
ODMDATA ?= "0xA4000"
EMMC_BCT ?= "P3448_A00_lpddr4_204Mhz_P987.cfg"
NVIDIA_BOARD ?= "t210ref"
NVIDIA_BOARD_CFG ?= ""
PARTITION_LAYOUT_TEMPLATE ?= "flash_l4t_t210_emmc_p3448.xml"
```

## conf/machine/jetson-nano-devkit.conf
```bitbake
#@TYPE: Machine
#@NAME: Nvidia Jetson Nano
#@DESCRIPTION: Nvidia Jetson Nano dev board

KERNEL_ARGS ?= "console=ttyS0,115200 console=tty0 fbcon=map:0 net.ifnames=0"
IMAGE_ROOTFS_ALIGNMENT ?= "1024"

NVPMODEL ?= "nvpmodel_t210_jetson-nano"

TEGRA_BOARDID ?= "3448"
TEGRA_FAB ?= "200"
TEGRA_BOARDSKU ?= "0000"
# Extracted from l4t_generate_soc_bup.sh for BOARDID=3448 and board=jetson-nano-devkit
TEGRA_BUPGEN_SPECS ?= "fab=000;boardsku=0000 \
		       fab=100;boardsku=0000 \
		       fab=200;boardsku=0000 \
		       fab=300;boardsku=0000"

require conf/machine/include/tegra210.inc

KERNEL_ROOTSPEC_DEFAULT = "root=/dev/mmcblk0p${distro_bootpart} rw rootwait"

KERNEL_DEVICETREE ?= "tegra210-p3448-0000-p3449-0000-a02.dtb \
		      tegra210-p3448-0000-p3449-0000-b00.dtb \
"

UBOOT_MACHINE = "p3450-0000_defconfig"

EMMC_SIZE ?= ""
EMMC_DEVSECT_SIZE ?= "512"
BOOTPART_SIZE ?= ""
BOOTPART_LIMIT ?= "10485760"
ROOTFSPART_SIZE ?= "15032385536"
ODMDATA ?= "0xA4000"
EMMC_BCT ?= "P3448_A00_lpddr4_204Mhz_P987.cfg"
NVIDIA_BOARD ?= "t210ref"
NVIDIA_BOARD_CFG ?= ""
PARTITION_LAYOUT_TEMPLATE ?= "flash_l4t_t210_max-spi_sd_p3448.xml"
TEGRA_SPIFLASH_BOOT ?= "1"
TEGRAFLASH_SDCARD_SIZE ?= "16G"
OTABOOTDEV ?= "/dev/mtdblock0"
OTAGPTDEV ?= "/dev/mtdblock0"
BOOT_PARTITIONS_ON_EMMC = "0"
```

## conf/machine/jetson-nano-qspi-sd.conf
```bitbake
#@TYPE: Machine
#@NAME: Nvidia Jetson Nano
#@DESCRIPTION: Nvidia Jetson Nano dev board

KERNEL_ARGS ?= "console=ttyS0,115200 console=tty0 fbcon=map:0 net.ifnames=0"
KERNEL_ROOTSPEC ?= "root=/dev/mmcblk0p${@uboot_var('distro_bootpart')} rw rootwait"
IMAGE_ROOTFS_ALIGNMENT ?= "1024"

NVPMODEL ?= "nvpmodel_t210_jetson-nano"

TEGRA_BOARDID ?= "3448"
TEGRA_FAB ?= "200"
TEGRA_BOARDSKU ?= "0000"
# Extracted from l4t_generate_soc_bup.sh for BOARDID=3448 and board=jetson-nano-qspi-sd
TEGRA_BUPGEN_SPECS ?= "fab=100 fab=200 fab=300 fab=400"

require conf/machine/include/tegra210.inc

KERNEL_DEVICETREE ?= "_ddot_/_ddot_/_ddot_/_ddot_/nvidia/platform/t210/porg/kernel-dts/tegra210-p3448-0000-p3449-0000-a02.dtb \
		      _ddot_/_ddot_/_ddot_/_ddot_/nvidia/platform/t210/porg/kernel-dts/tegra210-p3448-0000-p3449-0000-b00.dtb"

MACHINE_FEATURES += "ext2 ext3 vfat"

UBOOT_MACHINE = "p3450-porg_defconfig"

EMMC_SIZE ?= ""
EMMC_DEVSECT_SIZE ?= "512"
BOOTPART_SIZE ?= ""
BOOTPART_LIMIT ?= "10485760"
ROOTFSPART_SIZE ?= "15032385536"
ODMDATA ?= "0x94000"
EMMC_BCT ?= "P3448_A00_4GB_Micron_4GB_lpddr4_204Mhz_P987.cfg"
NVIDIA_BOARD ?= "t210ref"
NVIDIA_PRODUCT ?= "p3450-porg"
NVIDIA_BOARD_CFG ?= ""
PARTITION_LAYOUT_TEMPLATE ?= "flash_l4t_t210_spi_sd_p3448.xml"
TEGRA_SPIFLASH_BOOT ?= "1"
TEGRAFLASH_SDCARD_SIZE ?= "16G"
OTABOOTDEV ?= "/dev/mtdblock0"
OTAGPTDEV ?= "/dev/mtdblock0"
```

## conf/machine/jetson-nano.conf
```bitbake
#@TYPE: Machine
#@NAME: Nvidia Jetson Nano
#@DESCRIPTION: Nvidia Jetson Nano dev board

KERNEL_ARGS ?= "console=tty0 OS=l4t fbcon=map:0 sdhci_tegra.en_boot_part_access=1"

require conf/machine/include/tegra210.inc

KERNEL_DEVICETREE ?= "_ddot_/_ddot_/_ddot_/_ddot_/nvidia/platform/t210/porg/kernel-dts/tegra210-p3448-0000-p3449-0000-a02.dtb"

MACHINE_FEATURES += "ext2 ext3 vfat"

UBOOT_MACHINE = "p3450-porg_defconfig"

EMMC_SIZE ?= "4194304"
EMMC_DEVSECT_SIZE ?= "512"
BOOTPART_SIZE ?= "8388608"
BOOTPART_LIMIT ?= "10485760"
BLBLOCKSIZE ?= "1048576"
ROOTFSPART_SIZE ?= "12884901888"
ODMDATA ?= "0x94000"
EMMC_BCT ?= "P3448_A00_4GB_Micron_4GB_lpddr4_204Mhz_P987.cfg"
NVIDIA_BOARD ?= "t210ref"
NVIDIA_PRODUCT ?= "p3450-porg"
NVIDIA_BOARD_CFG ?= ""
TEGRA210_REDUNDANT_BOOT ?= "0"
PARTITION_LAYOUT_TEMPLATE ?= "flash_l4t_t210_spi_p3448.xml"
```

## conf/machine/jetson-orin-nano-devkit-nvme.conf
```bitbake
#@TYPE: Machine
#@NAME: Nvidia Jetson Orin Nano devkit
#@DESCRIPTION: Nvidia Jetson Orin Nano devkit using NVMe drive for rootfs

MACHINEOVERRIDES =. "jetson-orin-nano-devkit:"
TNSPEC_BOOTDEV ?= "nvme0n1p1"
PARTITION_LAYOUT_TEMPLATE_DEFAULT ?= "flash_t234_qspi.xml"
PARTITION_LAYOUT_TEMPLATE_DEFAULT_SUPPORTS_REDUNDANT ?= "1"
PARTITION_LAYOUT_EXTERNAL_DEFAULT ?= "flash_l4t_t234_nvme.xml"

require conf/machine/include/orin-nano.inc
require conf/machine/include/devkit-wifi.inc
```

## conf/machine/jetson-orin-nano-devkit-with-nx-module.conf
```bitbake
#@TYPE: Machine
#@NAME: Nvidia Jetson Orin NX
#@DESCRIPTION: Nvidia Jetson Orin NX development kit

TEGRA_BOARDID ?= "3767"
TEGRA_FAB ?= "ES1"
TEGRA_BOARDSKU ?= "0000"
TEGRA_BOARDREV ?= "A.3"
TEGRA_CHIPREV ?= "1"
NVPMODEL ?= "nvpmodel_p3767_0000"
NVFANCONTROL ?= "nvfancontrol_p3767_0000"

TNSPEC_BOOTDEV ?= "nvme0n1p1"

TEGRAFLASH_NO_INTERNAL_STORAGE = "1"

require conf/machine/include/tegra234.inc
require conf/machine/include/devkit-wifi.inc

KERNEL_DEVICETREE ?= "tegra234-p3767-0000-p3768-0000-a0.dtb"
KERNEL_ARGS ?= "mminit_loglevel=4 console=ttyTCU0,115200 firmware_class.path=/etc/firmware fbcon=map:0 net.ifnames=0"
MACHINE_EXTRA_RRECOMMENDS += "kernel-module-r8168 kernel-module-r8169 kernel-module-realtek"
MACHINE_EXTRA_RDEPENDS += "linux-firmware-rtl8168"

EMMC_SIZE ?= ""
BOOTPART_SIZE ?= "8388608"
# 55GiB default rootfs size
ROOTFSPART_SIZE ?= "59055800320"
ODMDATA ?= "gbe-uphy-config-8,hsstp-lane-map-3,hsio-uphy-config-0"
EMMC_BCT ?= "tegra234-p3767-0000-sdram-l4t.dts"
NVIDIA_BOARD ?= "t186ref"
PARTITION_LAYOUT_TEMPLATE ?= "flash_t234_qspi_sd.xml"
TEGRA_AUDIO_DEVICE ?= "tegra-hda-p3767-p3509"

OTABOOTDEV ?= "/dev/mtdblock0"
OTAGPTDEV ?= "/dev/mtdblock0"

TEGRA_PLUGIN_MANAGER_OVERLAYS = "tegra234-p3767-0000-p3509-a02-hdr40.dtbo"
```

## conf/machine/jetson-orin-nano-devkit.conf
```bitbake
#@TYPE: Machine
#@NAME: Nvidia Jetson Orin Nano devkit
#@DESCRIPTION: Nvidia Jetson Orin Nano devkit

require conf/machine/include/orin-nano.inc
require conf/machine/include/devkit-wifi.inc

TNSPEC_BOOTDEV_DEFAULT ?= "mmcblk1p1"
TEGRAFLASH_SDCARD_SIZE ?= "32G"
PARTITION_LAYOUT_TEMPLATE_DEFAULT ?= "flash_t234_qspi_sd.xml"
```

## conf/machine/jetson-tk1.conf
```bitbake
#@TYPE: Machine
#@NAME: Nvidia Jetson TK1
#@DESCRIPTION: Nvidia Jetson TK1 dev board

require conf/machine/include/tegra124.inc

KERNEL_DEVICETREE ?= "tegra124-jetson_tk1-pm375-000-c00-00.dtb"

KERNEL_ARGS = "console=ttyS0,115200 console=tty1 no_console_suspend=1 lp0_vec=2064@0xf46ff000 mem=2015M@2048M memtype=255 ddr_die=2048M@2048M section=256M pmuboard=0x0177:0x0000:0x02:0x43:0x00 tsec=32M@3913M otf_key=c75e5bb91eb3bd947560357b64422f85 usbcore.old_scheme_first=1 usbcore.autosuspend=-1 core_edp_mv=1150 core_edp_ma=4000 tegraid=40.1.1.0.0 debug_uartport=lsport,3 power_supply=Adapter audio_codec=rt5640 modem_id=0 android.kerneltype=normal fbcon=map:1 commchip_id=0 usb_port_owner_info=0 lane_owner_info=6 emc_max_dvfs=0 touch_id=0@0 board_info=0x0177:0x0000:0x02:0x43:0x00 gpt"

MACHINE_FEATURES += "ext2 ext3 vfat"

UBOOT_MACHINE = "jetson-tk1_defconfig"

EMMC_SIZE ?= "15766388736"
EMMC_DEVSECT_SIZE ?= "512"
BOOTPART_SIZE ?= "8388608"
BOOTPART_LIMIT ?= "10485760"
ROOTFSPART_SIZE ?= "15032385536"
# set ODMDATA to 0x6209C000 for USB 3.0
ODMDATA ?= "0x6009C000"
EMMC_BCT ?= "PM375_Hynix_2GB_H5TC4G63AFR_H5TC4G63CFR_RDA_924MHz.cfg"
NVIDIA_BOARD ?= "ardbeg"
PARTITION_LAYOUT_TEMPLATE ?= "gnu_linux_fastboot_emmc_full.cfg"
IMAGE_TEGRAFLASH_FS_TYPE ?= "ext3"

TEGRA_AUDIO_DEVICE ?= "tegrart5639"
```

## conf/machine/jetson-tx1-devkit.conf
```bitbake
#@TYPE: Machine
#@NAME: Nvidia Jetson TX1
#@DESCRIPTION: Nvidia Jetson TX1 dev board

KERNEL_ARGS ?= "console=ttyS0,115200 console=tty0 fbcon=map:0 net.ifnames=0 sdhci_tegra.en_boot_part_access=1"

# Extracted from l4t_generate_soc_bup.sh for BOARDID=2180 and board=jetson-tx1-devkit
TEGRA_BUPGEN_SPECS ?= "fab=100"

require conf/machine/include/tegra210.inc

MACHINE_EXTRA_RRECOMMENDS += "tegra-firmware-brcm kernel-module-bcmdhd kernel-module-ov5693"

KERNEL_DEVICETREE ?= "tegra210-jetson-tx1-p2597-2180-a01-devkit.dtb"

MACHINE_FEATURES += "wifi bluetooth"

UBOOT_MACHINE = "p2371-2180_defconfig"

EMMC_SIZE ?= "15758000128"
EMMC_DEVSECT_SIZE ?= "512"
BOOTPART_SIZE ?= "8388608"
BOOTPART_LIMIT ?= "10485760"
ROOTFSPART_SIZE ?= "15032385536"
ODMDATA ?= "0xA4000"
EMMC_BCT ?= "P2180_A00_LP4_DSC_204Mhz.cfg"
NVIDIA_BOARD ?= "t210ref"
NVIDIA_BOARD_CFG ?= "board_config_p2597-devkit.xml"
PARTITION_LAYOUT_TEMPLATE ?= "gnu_linux_tegraboot_emmc_full.xml"
```

## conf/machine/jetson-tx1.conf
```bitbake
#@TYPE: Machine
#@NAME: Nvidia Jetson TX1
#@DESCRIPTION: Nvidia Jetson TX1 dev board

KERNEL_ARGS ?= "console=tty0 fbcon=map:0 net.ifnames=0 sdhci_tegra.en_boot_part_access=1"

require conf/machine/include/tegra210.inc

MACHINE_EXTRA_RRECOMMENDS = "tegra-firmware-brcm kernel-module-bcmdhd"

KERNEL_DEVICETREE ?= "_ddot_/_ddot_/_ddot_/_ddot_/nvidia/platform/t210/jetson/kernel-dts/tegra210-jetson-tx1-p2597-2180-a01-devkit.dtb"

MACHINE_FEATURES += "ext2 ext3 vfat wifi bluetooth"

UBOOT_MACHINE = "p2371-2180_defconfig"

EMMC_SIZE ?= "15758000128"
EMMC_DEVSECT_SIZE ?= "512"
BOOTPART_SIZE ?= "8388608"
BOOTPART_LIMIT ?= "10485760"
ROOTFSPART_SIZE ?= "12884901888"
ODMDATA ?= "0x84000"
EMMC_BCT ?= "P2180_A00_LP4_DSC_204Mhz.cfg"
NVIDIA_BOARD ?= "t210ref"
NVIDIA_PRODUCT ?= "p2371-2180-devkit"
NVIDIA_BOARD_CFG ?= "board_config_p2597-devkit.xml"
TEGRA210_REDUNDANT_BOOT ?= "0"
PARTITION_LAYOUT_TEMPLATE ?= "gnu_linux_tegraboot_emmc_full.xml"
```

## conf/machine/jetson-tx2-4gb.conf
```bitbake
#@TYPE: Machine
#@NAME: Nvidia Jetson TX2 4GB
#@DESCRIPTION: Machine configuration for Nvidia Jetson TX2 4GB variant

require conf/machine/include/tegra186.inc

KERNEL_DEVICETREE ?= "_ddot_/_ddot_/_ddot_/_ddot_/nvidia/platform/t18x/quill/kernel-dts/tegra186-quill-p3489-0888-a00-00-base.dtb"

UBOOT_MACHINE = "p2771-0000-500_defconfig"

EMMC_SIZE ?= "15758000128"
BOOTPART_SIZE ?= "8388608"
BOOTPART_LIMIT ?= "10485760"
ROOTFSPART_SIZE ?= "15032385536"
ODMDATA ?= "0x1090000"
EMMC_BCT ?= "P3489_Sku888_4GB_Hynix_4GB_lpddr4_204Mhz_P138_A02_l4t.cfg"
NVIDIA_BOARD ?= "t186ref"
PARTITION_LAYOUT_TEMPLATE ?= "flash_l4t_t186.xml"

TEGRA_BOARDID ?= "3489"
TEGRA_FAB ?= "300"
TEGRA_BOARDSKU ?= ""
TEGRA_BOARDREV ?= ""
TEGRA_CHIPREV ?= "0"
# Extracted from l4t_generate_soc_bup.sh for BOARDID=3489 and board=jetson-tx2-4gb
TEGRA_BUPGEN_SPECS ?= "fab=300"
```

## conf/machine/jetson-tx2-devkit.conf
```bitbake
#@TYPE: Machine
#@NAME: Nvidia Jetson TX2
#@DESCRIPTION: Nvidia Jetson TX2 dev board

require conf/machine/include/tegra186.inc

MACHINE_EXTRA_RRECOMMENDS += "tegra-firmware-brcm kernel-module-bcmdhd kernel-module-ov5693"

KERNEL_DEVICETREE ?= "tegra186-quill-p3310-1000-c03-00-base.dtb"

MACHINE_FEATURES += "wifi bluetooth"

UBOOT_MACHINE = "p2771-0000-500_defconfig"

EMMC_SIZE ?= "31276924928"
EMMC_DEVSECT_SIZE ?= "512"
BOOTPART_SIZE ?= "8388608"
BOOTPART_LIMIT ?= "10485760"
ROOTFSPART_SIZE ?= "30064771072"
ODMDATA ?= "0x1090000"
EMMC_BCT ?= "P3310_A00_8GB_lpddr4_A02_l4t.cfg"
NVIDIA_BOARD ?= "t186ref"
PARTITION_LAYOUT_TEMPLATE ?= "flash_l4t_t186.xml"

TEGRA_FAB ?= "C04"
TEGRA_BOARDID ?= "3310"
TEGRA_BOARDSKU ?= ""
TEGRA_BOARDREV ?= ""
TEGRA_CHIPREV ?= "0"
# Extracted from l4t_generate_soc_bup.sh for BOARDID=3310 and board=jetson-tx2-devkit
TEGRA_BUPGEN_SPECS ?= "fab=B00 fab=B01"
```

## conf/machine/jetson-tx2.conf
```bitbake
#@TYPE: Machine
#@NAME: Nvidia Jetson TX2
#@DESCRIPTION: Nvidia Jetson TX2 dev board

require conf/machine/include/tegra186.inc

KERNEL_DEVICETREE ?= "_ddot_/_ddot_/_ddot_/_ddot_/nvidia/platform/t18x/quill/kernel-dts/tegra186-quill-p3310-1000-c03-00-base.dtb"
KERNEL_ARGS ?= "console=ttyS0,115200 console=tty0 OS=l4t fbcon=map:0"

MACHINE_FEATURES += "ext2 ext3 vfat"

UBOOT_MACHINE = "p2771-0000-500_defconfig"

EMMC_SIZE ?= "31276924928"
EMMC_DEVSECT_SIZE ?= "512"
BOOTPART_SIZE ?= "8388608"
BOOTPART_LIMIT ?= "10485760"
ROOTFSPART_SIZE ?= "30064771072"
ODMDATA ?= "0x1090000"
EMMC_BCT ?= "P3310_A00_8GB_Samsung_8GB_lpddr4_204Mhz_A02_l4t.cfg"
NVIDIA_BOARD ?= "t186ref"
PARTITION_LAYOUT_TEMPLATE ?= "flash_l4t_t186.xml"
```

## conf/machine/jetson-tx2i.conf
```bitbake
#@TYPE: Machine
#@NAME: Nvidia Jetson TX2i
#@DESCRIPTION: Nvidia Jetson TX2i dev board

TEGRA_UCM ?= "ucm1"
NVPMODEL ?= "nvpmodel_t186_storm_${TEGRA_UCM}"

TEGRA_BOARDID ?= "3489"
TEGRA_FAB ?= "300"
# Extracted from l4t_generate_soc_bup.sh for BOARDID=3489 and board=jetson-tx2i
TEGRA_BUPGEN_SPECS ?= "fab=300"

require conf/machine/include/tegra186.inc

KERNEL_DEVICETREE ?= "_ddot_/_ddot_/_ddot_/_ddot_/nvidia/platform/t18x/quill/kernel-dts/tegra186-quill-p3489-1000-a00-00-${TEGRA_UCM}.dtb"

UBOOT_MACHINE = "p2771-0000-500_defconfig"

EMMC_SIZE ?= "31276924928"
EMMC_DEVSECT_SIZE ?= "512"
BOOTPART_SIZE ?= "8388608"
BOOTPART_LIMIT ?= "10485760"
ROOTFSPART_SIZE ?= "30064771072"
ODMDATA ?= "0x1090000"
EMMC_BCT ?= "P3489_A00_8GB_Samsung_8GB_lpddr4_204Mhz_P134_A02_ECC_en_l4t.cfg"
NVIDIA_BOARD ?= "t186ref"
PARTITION_LAYOUT_TEMPLATE ?= "flash_l4t_t186.xml"
```

## conf/machine/jetson-xavier-8gb.conf
```bitbake
#@TYPE: Machine
#@NAME: Nvidia Jetson Xavier 8GB
#@DESCRIPTION: Nvidia Jetson Xavier 8GB machine variant

KERNEL_DEVICETREE ?= "_ddot_/_ddot_/_ddot_/_ddot_/nvidia/platform/t19x/galen/kernel-dts/tegra194-p2888-0006-p2822-0000.dtb"
EMMC_BCT ?= "tegra194-mb1-bct-memcfg-p2888-0006.cfg"
EMMC_BCT_OVERRIDE ?= "tegra194-memcfg-sw-override.cfg"

TEGRA_BOARDSKU ?= "0006"
TEGRA_BOARDREV ?= "B.0"
# Extracted from l4t_generate_soc_bup.sh for BOARDID=2888 and board=jetson-xavier-8gb
TEGRA_BUPGEN_SPECS ?= "fab=400;boardsku=0006;boardrev=B.0"

NVPMODEL ?= "nvpmodel_t194_8gb"

include conf/machine/jetson-xavier.conf
```
