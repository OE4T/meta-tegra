## conf/machine/jetson-xavier-nx-devkit-emmc.conf
```bitbake
#@TYPE: Machine
#@NAME: Nvidia Jetson Xavier NX dev kit - eMMC
#@DESCRIPTION: Nvidia Jetson Xavier NX development kit with QSPI+eMMC
#              module

TEGRA_BOARDSKU ?= "0001"
TEGRA_BUPGEN_SPECS ?= "fab=100;boardsku=0001;boardrev= \
		       fab=200;boardsku=0001;boardrev="
IMAGE_ROOTFS_ALIGNMENT ?= "4"

require conf/machine/include/xavier-nx.inc

EMMC_SIZE ?= "15758000128"
PARTITION_LAYOUT_TEMPLATE ?= "flash_l4t_t194_spi_emmc_p3668.xml"
```

## conf/machine/jetson-xavier-nx-devkit-tx2-nx.conf
```bitbake
#@TYPE: Machine
#@NAME: Nvidia Jetson TX2 NX
#@DESCRIPTION: Machine configuration for Nvidia Jetson TX2 NX module installed in the Xavier NX carrier

require conf/machine/include/tegra186.inc

KERNEL_DEVICETREE ?= "_ddot_/_ddot_/_ddot_/_ddot_/nvidia/platform/t18x/lanai/kernel-dts/tegra186-p3636-0001-p3509-0000-a01.dtb"

MACHINE_FEATURES += "wifi bluetooth"
MACHINE_EXTRA_RRECOMMENDS += "kernel-module-rtk-btusb kernel-module-rtl8822ce tegra-firmware-rtl8822"
TEGRA_BT_SUPPORT_PACKAGE = ""

UBOOT_MACHINE = "p3636-0001_defconfig"

EMMC_SIZE ?= "15758000128"
BOOTPART_SIZE ?= "8388608"
BOOTPART_LIMIT ?= "10485760"
ROOTFSPART_SIZE ?= "15032385536"
RECROOTFSSIZE ?= "104857600"
ODMDATA ?= "0x2090000"
EMMC_BCT ?= "tegra186-mb1-bct-memcfg-p3636-0001-a01.cfg"
NVIDIA_BOARD ?= "t186ref"
PARTITION_LAYOUT_TEMPLATE ?= "flash_l4t_t186.xml"

TEGRA_BOARDID ?= "3636"
TEGRA_FAB ?= "300"
TEGRA_BOARDSKU ?= "0001"
TEGRA_BOARDREV ?= ""
TEGRA_CHIPREV ?= "0"
# Extracted from l4t_generate_soc_bup.sh for BOARDID=3636 and board=jetson-xavier-nx-devkit-tx2-nx
TEGRA_BUPGEN_SPECS ?= "fab=300;boardsku=0001"
```

## conf/machine/jetson-xavier-nx-devkit-uefi-acpi.conf
```bitbake
MACHINEOVERRIDES =. "uefi-acpi:"
require conf/machine/jetson-xavier-nx-devkit-uefi.conf
```

## conf/machine/jetson-xavier-nx-devkit-uefi.conf
```bitbake
#@TYPE: Machine
#@NAME: Nvidia Jetson Xavier NX dev kit
#@DESCRIPTION: Nvidia Jetson Xavier NX development kit with
#              QSPI+SDcard module (SKU 0000)

TEGRA_BOARDSKU ?= "0000"
TEGRA_BUPGEN_SPECS ?= "fab=100;boardsku=0000;boardrev= \
		       fab=200;boardsku=0000;boardrev= \
		       fab=300;boardsku=0000;boardrev="
IMAGE_ROOTFS_ALIGNMENT ?= "1024"

KERNEL_DEVICETREE ?= "nvidia/tegra194-p3509-0000+p3668-0000.dtb"
KERNEL_ROOTSPEC ?= "root=/dev/mmcblk0p1 rootwait"
KERNEL_ARGS ?= "earlycon=uart8250,mmio32,0x3100000 console=ttyS0,115200 fbcon=map:0 ${KERNEL_ROOTSPEC}"
SERIAL_CONSOLES ?= "115200;ttyS0"

PREFERRED_PROVIDER_virtual/bootloader ?= "jetson-uefi-prebuilt"
PREFERRED_PROVIDER_virtual/kernel ?= "linux-tegra-upstream"

require conf/machine/include/xavier-nx.inc

MACHINEOVERRIDES =. "uefi:"
MACHINE_ESSENTIAL_EXTRA_RDEPENDS = "linux-firmware-nvidia-tegra linux-firmware"
TEGRA_INITRD_FIRMWARE ?= "linux-firmware-nvidia-tegra"
KERNEL_MODULE_AUTOLOAD = ""

EMMC_SIZE ?= ""
PARTITION_LAYOUT_TEMPLATE ?= "flash_t194_uefi_spi_sd_p3668.xml"
TEGRA_SPIFLASH_BOOT ?= "1"
TEGRAFLASH_SDCARD_SIZE ?= "16G"
```

## conf/machine/jetson-xavier-nx-devkit.conf
```bitbake
#@TYPE: Machine
#@NAME: Nvidia Jetson Xavier NX dev kit
#@DESCRIPTION: Nvidia Jetson Xavier NX development kit with
#              QSPI+SDcard module (SKU 0000)

TEGRA_BOARDSKU ?= "0000"
TEGRA_BUPGEN_SPECS ?= "fab=100;boardsku=0000;boardrev= \
		       fab=301;boardsku=0000;boardrev="
IMAGE_ROOTFS_ALIGNMENT ?= "1024"

TEGRA_FLASHVAR_MISC_COLD_BOOT_CONFIG ?= "tegra194-mb1-bct-misc-l4t.cfg"

require conf/machine/include/xavier-nx.inc
require conf/machine/include/devkit-wifi.inc

EMMC_SIZE ?= ""
PARTITION_LAYOUT_TEMPLATE_DEFAULT ?= "flash_l4t_t194_spi_sd_p3668.xml"
TEGRA_SPIFLASH_BOOT ?= "1"
TEGRAFLASH_SDCARD_SIZE ?= "16G"
```

## conf/machine/jetson-xavier-uefi-acpi.conf
```bitbake
#@TYPE: Machine
#@NAME: Nvidia Jetson Xavier
#@DESCRIPTION: Nvidia Jetson Xavier dev board, UEFI+ACPI

MACHINEOVERRIDES = "jetson-xavier:uefi:uefi-acpi:${MACHINE}"
KERNEL_ROOTSPEC ?= "root=/dev/mmcblk1p1 rootwait"

require conf/machine/include/agx-xavier-uefi.inc
```

## conf/machine/jetson-xavier-uefi.conf
```bitbake
#@TYPE: Machine
#@NAME: Nvidia Jetson Xavier
#@DESCRIPTION: Nvidia Jetson Xavier dev board, UEFI

MACHINEOVERRIDES = "jetson-xavier:uefi:${MACHINE}"
KERNEL_ROOTSPEC ?= "root=/dev/mmcblk0p1 rootwait"

require conf/machine/include/agx-xavier-uefi.inc
```

## conf/machine/jetson-xavier.conf
```bitbake
#@TYPE: Machine
#@NAME: Nvidia Jetson Xavier
#@DESCRIPTION: Nvidia Jetson Xavier dev board

require conf/machine/include/tegra194.inc

KERNEL_DEVICETREE ?= "_ddot_/_ddot_/_ddot_/_ddot_/nvidia/platform/t19x/galen/kernel-dts/tegra194-p2888-0001-p2822-0000.dtb"

MACHINE_FEATURES += "ext2 ext3 vfat"

EMMC_SIZE ?= "31276924928"
EMMC_DEVSECT_SIZE ?= "512"
BOOTPART_SIZE ?= "8388608"
BOOTPART_LIMIT ?= "10485760"
ROOTFSPART_SIZE ?= "30064771072"
ODMDATA ?= "0x9190000"
EMMC_BCT ?= "tegra194-mb1-bct-memcfg-p2888.cfg"
EMMC_BCT_OVERRIDE ?= "tegra194-memcfg-sw-override.cfg"
NVIDIA_BOARD ?= "t186ref"
TEGRA186_REDUNDANT_BOOT ?= "0"
PARTITION_LAYOUT_TEMPLATE ?= "flash_t194_sdmmc.xml"
```

## conf/machine/p3509-a02-p3767-0000.conf
```bitbake
#@TYPE: Machine
#@NAME: Nvidia Jetson Orin NX 16GB (P3767-0000)
#@DESCRIPTION: Nvidia Jetson Orin NX 16GB module in P3509 carrier

TEGRA_FLASHVAR_PINMUX_CONFIG ?= "tegra234-mb1-bct-pinmux-p3767-hdmi-a03.dtsi"
TEGRA_FLASHVAR_PMC_CONFIG ?= "tegra234-mb1-bct-padvoltage-p3767-hdmi-a03.dtsi"
TEGRA_PLUGIN_MANAGER_OVERLAYS ?= "tegra234-carveouts.dtbo tegra-optee.dtbo tegra234-p3768-0000+p3767-0000-dynamic.dtbo tegra234-dcb-p3767-0000-hdmi.dtbo"
TEGRA_DCE_OVERLAY ?= "tegra234-dcb-p3767-0000-hdmi.dtbo"

require conf/machine/include/orin-nx.inc
```
