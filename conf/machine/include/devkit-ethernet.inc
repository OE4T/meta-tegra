## conf/machine/include/devkit-ethernet.inc
```bitbake
# 10G Ethernet (Orin AGX only) built as module in kernel cache
LINUX_ETHERNET:tegra234 = "kernel-module-aquantia"
NVIDIA_ETHERNET:tegra234 = ""

LINUX_ETHERNET:tegra264 = "kernel-module-r8169 kernel-module-realtek linux-firmware-rtl-nic"
NVIDIA_ETHERNET:tegra264 = "kernel-module-r8126"

DEVKIT_ETHERNET_RRECOMMENDS ?= "${@'${NVIDIA_ETHERNET}' if d.getVar('PREFERRED_PROVIDER_virtual/kernel') == 'linux-noble-nvidia-tegra' else '${LINUX_ETHERNET}'}"

MACHINE_EXTRA_RRECOMMENDS += "${DEVKIT_ETHERNET_RRECOMMENDS}"
```

## conf/machine/include/devkit-wifi.inc
```bitbake
MACHINE_FEATURES += "wifi bluetooth"

LINUX_WIFI:tegra264 = "kernel-module-rtw89-8852ce linux-firmware-rtl8852"
NVIDIA_WIFI:tegra264 = "kernel-module-rtl8852ce tegra-firmware-rtl8852"

LINUX_WIFI:tegra234 = "kernel-module-rtw88-8822ce linux-firmware-rtl8822"
NVIDIA_WIFI:tegra234 = "kernel-module-rtl8822ce tegra-firmware-rtl8822"

DEVKIT_WIFI_RRECOMMENDS ?= "${@'${NVIDIA_WIFI}' if d.getVar('PREFERRED_PROVIDER_virtual/kernel') == 'linux-noble-nvidia-tegra' else '${LINUX_WIFI}'}"

MACHINE_EXTRA_RRECOMMENDS += " \
    kernel-module-rtk-btusb \
    ${DEVKIT_WIFI_RRECOMMENDS} \
"
TEGRA_BT_SUPPORT_PACKAGE ?= ""
```

## conf/machine/include/p3737.inc
```bitbake
# Peripheral configuration for p3737-0000 carrier (Orin AGX dev kit)
MACHINE_FEATURES += "wifi bluetooth"

LINUX_ETHERNET = "kernel-module-aquantia"
NVIDIA_ETHERNET = ""

DEVKIT_ETHERNET_RRECOMMENDS ?= "${@'${NVIDIA_ETHERNET}' if d.getVar('TEGRA_USING_VENDOR_KERNEL') else '${LINUX_ETHERNET}'}"

LINUX_WIFI = "kernel-module-rtw88-8822ce linux-firmware-rtl8822"
NVIDIA_WIFI = "kernel-module-rtl8822ce tegra-firmware-rtl8822"

DEVKIT_WIFI_RRECOMMENDS ?= "${@'${NVIDIA_WIFI}' if d.getVar('TEGRA_USING_VENDOR_KERNEL') else '${LINUX_WIFI}'}"

MACHINE_EXTRA_RRECOMMENDS += " \
    ${DEVKIT_ETHERNET_RRECOMMENDS} \
    kernel-module-rtk-btusb \
    ${DEVKIT_WIFI_RRECOMMENDS} \
    kernel-module-snd-soc-rl6231 \
    kernel-module-snd-soc-rt5640 \
"
TEGRA_BT_SUPPORT_PACKAGE ?= ""
```

## conf/machine/include/p3768.inc
```bitbake
# Peripheral configuration for p3768-0000 carrier (Orin NX/Nano dev kit)
MACHINE_FEATURES += "wifi bluetooth"

LINUX_WIFI = "kernel-module-rtw88-8822ce linux-firmware-rtl8822"
LINUX_ETHERNET = "kernel-module-r8169"
NVIDIA_WIFI = "nv-kernel-module-rtl8822ce"
NVIDIA_ETHERNET = "nv-kernel-module-r8168"

DEVKIT_WIFI_RRECOMMENDS ?= "${@'${NVIDIA_WIFI}' if d.getVar('TEGRA_USING_VENDOR_KERNEL') else '${LINUX_WIFI}'}"
DEVKIT_ETHERNET_RRECOMMENDS ?= "${@'${NVIDIA_ETHERNET}' if d.getVar('TEGRA_USING_VENDOR_KERNEL') else '${LINUX_ETHERNET}'} kernel-module-realtek linux-firmware-rtl8168"

MACHINE_EXTRA_RRECOMMENDS += " \
    nv-kernel-module-rtk-btusb \
    tegra-firmware-rtl8822 \
    ${DEVKIT_WIFI_RRECOMMENDS} \
    ${DEVKIT_ETHERNET_RRECOMMENDS} \
"

TEGRA_BT_SUPPORT_PACKAGE ?= ""
```

## conf/machine/include/p4071.inc
```bitbake
# Peripheral configuration for p4071-0000 carrier (AGX Thor dev kit)
MACHINE_FEATURES += "wifi bluetooth"

LINUX_ETHERNET = "kernel-module-r8169 kernel-module-realtek linux-firmware-rtl-nic"
NVIDIA_ETHERNET = "kernel-module-r8126"

DEVKIT_ETHERNET_RRECOMMENDS ?= "${@'${NVIDIA_ETHERNET}' if d.getVar('TEGRA_USING_VENDOR_KERNEL') else '${LINUX_ETHERNET}'}"

LINUX_WIFI = "kernel-module-rtw89-8852ce linux-firmware-rtl8852"
NVIDIA_WIFI = "kernel-module-rtl8852ce tegra-firmware-rtl8852"

DEVKIT_WIFI_RRECOMMENDS ?= "${@'${NVIDIA_WIFI}' if d.getVar('TEGRA_USING_VENDOR_KERNEL') else '${LINUX_WIFI}'}"

MACHINE_EXTRA_RRECOMMENDS += " \
    ${DEVKIT_ETHERNET_RRECOMMENDS} \
    kernel-module-rtk-btusb \
    ${DEVKIT_WIFI_RRECOMMENDS} \
    kernel-module-snd-soc-rl6231 \
    kernel-module-snd-soc-rt5640 \
"
TEGRA_BT_SUPPORT_PACKAGE ?= ""
```
