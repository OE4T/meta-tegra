## conf/machine/p3737-0000-p3701-0004.conf
```bitbake
#@TYPE: Machine
#@NAME: Nvidia Jetson AGX Orin 32GB
#@DESCRIPTION: Nvidia Jetson Orin dev kit (P3701-0004 module in P3737-0000 carrier)

TEGRA_BOARDSKU ?= "0004"
TEGRA_BUPGEN_SPECS ?= "fab=300;boardsku=0004;boardrev=;chipsku=00:00:00:D0;bup_type=bl \
                       fab=300;boardsku=0004;boardrev=;bup_type=kernel"
KERNEL_DEVICETREE ?= "tegra234-p3737-0000+p3701-0004-nv.dtb"
TEGRA_FLASHVAR_PMIC_CONFIG ?= "tegra234-mb1-bct-pmic-p3701-0005.dts"

require conf/machine/include/agx-orin.inc
require conf/machine/include/devkit-wifi.inc
```

## conf/machine/p3737-0000-p3701-0005.conf
```bitbake
#@TYPE: Machine
#@NAME: Nvidia Jetson AGX Orin 64GB
#@DESCRIPTION: Nvidia Jetson Orin dev kit (P3701-0005 module in P3737-0000 carrier)

TEGRA_BOARDSKU ?= "0005"
TEGRA_BUPGEN_SPECS ?= "fab=300;boardsku=0005;boardrev=;chipsku=00:00:00:D0;bup_type=bl \
                       fab=300;boardsku=0005;boardrev=;bup_type=kernel"
KERNEL_DEVICETREE ?= "tegra234-p3737-0000+p3701-0005-nv.dtb"
TEGRA_FLASHVAR_BPFDTB_FILE ?= "tegra234-bpmp-3701-0005-3737-0000.dtb"
TEGRA_FLASHVAR_PMIC_CONFIG ?= "tegra234-mb1-bct-pmic-p3701-0005.dts"
TEGRA_FLASHVAR_WB0SDRAM_BCT ?= "tegra234-p3701-0005-wb0sdram-l4t.dts"

EMMC_BCT ?= "tegra234-p3701-0005-sdram-l4t.dts"

require conf/machine/include/agx-orin.inc
require conf/machine/include/devkit-wifi.inc
```

## conf/machine/p3768-0000-p3767-0000.conf
```bitbake
#@TYPE: Machine
#@NAME: Nvidia Jetson Orin NX 16GB (P3767-0000)
#@DESCRIPTION: Nvidia Jetson Orin NX module in P3768 carrier

TEGRA_BOARDID ?= "3767"
TEGRA_FAB ?= "ES1"
TEGRA_BOARDSKU ?= "0000"
TEGRA_BOARDREV ?= "A.3"
TEGRA_CHIPREV ?= "1"
NVPMODEL ?= "nvpmodel_p3767_0000_super"
NVFANCONTROL ?= "nvfancontrol_p3767_0000"

TNSPEC_BOOTDEV ?= "nvme0n1p1"
PARTITION_LAYOUT_TEMPLATE_DEFAULT ?= "flash_t234_qspi.xml"
PARTITION_LAYOUT_TEMPLATE_DEFAULT_SUPPORTS_REDUNDANT ?= "1"
PARTITION_LAYOUT_EXTERNAL_DEFAULT ?= "flash_l4t_t234_nvme.xml"
TEGRAFLASH_NO_INTERNAL_STORAGE = "1"

require conf/machine/include/tegra234.inc
require conf/machine/include/devkit-wifi.inc

TEGRA_BUPGEN_SPECS ?= "fab=000;boardsku=0000;boardrev=;chipsku=00:00:00:D3;bup_type=bl \
                       fab=000;boardsku=0000;boardrev=;bup_type=kernel"

KERNEL_DEVICETREE ?= "tegra234-p3767-0000-super-p3768-0000-a0.dtb"
KERNEL_ARGS ?= "mminit_loglevel=4 console=ttyTCU0,115200 firmware_class.path=/etc/firmware fbcon=map:0 net.ifnames=0 nospectre_bhb"
MACHINE_EXTRA_RRECOMMENDS += "kernel-module-r8168 kernel-module-r8169 kernel-module-realtek"
MACHINE_EXTRA_RDEPENDS += "linux-firmware-rtl8168"

EMMC_SIZE ?= ""
BOOTPART_SIZE ?= "8388608"
# 55GiB default rootfs size
ROOTFSPART_SIZE_DEFAULT ?= "59055800320"
ODMDATA ?= "gbe-uphy-config-8,hsstp-lane-map-3,hsio-uphy-config-0"
EMMC_BCT ?= "tegra234-p3767-0000-sdram-l4t.dts"
NVIDIA_BOARD ?= "t186ref"
TEGRA_AUDIO_DEVICE ?= "tegra-hda-p3767-p3509"

OTABOOTDEV ?= "/dev/mtdblock0"
OTAGPTDEV ?= "/dev/mtdblock0"

TEGRA_PLUGIN_MANAGER_OVERLAYS ?= "tegra234-p3767-overlay.dtbo tegra234-p3768-overlay.dtbo"
```

## conf/machine/p3768-0000-p3767-0001.conf
```bitbake
#@TYPE: Machine
#@NAME: Nvidia Jetson Orin NX 8GB (P3767-0001)
#@DESCRIPTION: Nvidia Jetson Orin NX 8G module in P3768 carrier

NVPMODEL ?= "nvpmodel_p3767_0001_super"

TEGRA_BUPGEN_SPECS ?= "fab=000;boardsku=0001;boardrev=;chipsku=00:00:00:D4;bup_type=bl \
                       fab=000;boardsku=0001;boardrev=;bup_type=kernel"

TEGRA_BOARDSKU ?= "0001"
KERNEL_DEVICETREE ?= "tegra234-p3768-0000+p3767-0001-nv-super.dtb"
EMC_BCT ?= "tegra234-p3767-0001-sdram-l4t.dts"

TEGRA_FLASHVAR_BPFDTB_FILE ?= "tegra234-bpmp-3767-0001-3768-super.dtb"
TEGRA_FLASHVAR_CHIP_SKU ?= "00:00:00:D4"
TEGRA_FLASHVAR_WB0SDRAM_BCT ?= "tegra234-p3767-0001-wb0sdram-l4t.dts"

require conf/machine/include/orin-nx.inc
```

## conf/machine/p3768-0000-p3767-0003.conf
```bitbake
#@TYPE: Machine
#@NAME: Nvidia Jetson Orin Nano 8GB (P3767-0003)
#@DESCRIPTION: Nvidia Jetson Orin Nano 8G module in P3768 carrier

TEGRA_FAB ?= "300"
TEGRA_BOARDSKU ?= "0003"
TEGRA_BOARDREV ?= "P.1"

TEGRA_BUPGEN_SPECS ?= "fab=300;boardsku=0003;boardrev=;chipsku=00:00:00:D5;bup_type=bl \
                       fab=300;boardsku=0003;boardrev=;bup_type=kernel"

TNSPEC_BOOTDEV ?= "nvme0n1p1"
PARTITION_LAYOUT_TEMPLATE_DEFAULT ?= "flash_t234_qspi.xml"
PARTITION_LAYOUT_TEMPLATE_DEFAULT_SUPPORTS_REDUNDANT ?= "1"
PARTITION_LAYOUT_EXTERNAL_DEFAULT ?= "flash_l4t_t234_nvme.xml"
TEGRAFLASH_NO_INTERNAL_STORAGE = "1"

MACHINEOVERRIDES =. "p3767-0003:"

KERNEL_DEVICETREE ?= "tegra234-p3767-0003-super-p3768-0000-a0.dtb"

require conf/machine/include/orin-nano.inc
```

## conf/machine/p3768-0000-p3767-0004.conf
```bitbake
#@TYPE: Machine
#@NAME: Nvidia Jetson Orin Nano 4GB (p3767-0004)
#@DESCRIPTION: Nvidia Jetson Orin Nano 4GB module in p3768 carrier

MACHINEOVERRIDES =. "jetson-orin-nano-4g-devkit:"
TNSPEC_BOOTDEV ?= "nvme0n1p1"

PARTITION_LAYOUT_TEMPLATE_DEFAULT ?= "flash_t234_qspi.xml"
PARTITION_LAYOUT_TEMPLATE_DEFAULT_SUPPORTS_REDUNDANT ?= "1"
PARTITION_LAYOUT_EXTERNAL_DEFAULT ?= "flash_l4t_t234_nvme.xml"
TEGRAFLASH_NO_INTERNAL_STORAGE = "1"

TEGRA_BOARDSKU = "0004"
KERNEL_DEVICETREE ?= "tegra234-p3768-0000+p3767-0004-nv-super.dtb"
NVPMODEL ?= "nvpmodel_p3767_0004_super"
EMC_BCT ?= "tegra234-p3767-0004-sdram-l4t.dts"

TEGRA_FLASHVAR_BPFDTB_FILE ?= "tegra234-bpmp-3767-0004-3768-super.dtb"
TEGRA_FLASHVAR_CHIP_SKU ?= "00:00:00:D6"
TEGRA_FLASHVAR_RAMCODE ?= "4"
TEGRA_FLASHVAR_WB0SDRAM_BCT ?= "tegra234-p3767-0004-wb0sdram-l4t.dts"

TEGRA_BUPGEN_SPECS ?= "fab=000;boardsku=0004;boardrev=;chipsku=00:00:00:D6;bup_type=bl \
                       fab=000;boardsku=0004;boardrev=;bup_type=kernel"

require conf/machine/include/orin-nano.inc
require conf/machine/include/devkit-wifi.inc
```

## conf/machine/p3834-0005-p3971-0000.conf
```bitbake
#@TYPE: Machine
#@NAME: Nvidia AGX Thor dev kit
#@DESCRIPTION: Nvidia AGX Thor dev kit (P3834-0005 module in P3971-0000 carrier with NVMe)

TEGRA_BOARDSKU ?= "0005"
TEGRA_BOARDREV ?= "D.1"
NVPMODEL ?= "nvpmodel_p3834_0005"
NVFANCONTROL ?= "nvfancontrol_p3834_0005_p3971_0000"

KERNEL_DEVICETREE ?= "tegra264-p3971-0050+p3834-0005-qspi-nvme.dtb"

EMMC_BCT ?= "tegra264-p3834-0005-sdram-bct-l4t.dts"
TEGRA_FLASHVAR_BPFDTB_FILE ?= "tegra264-bpmp-3834-0005-3971-xxxx.dtb"
TEGRA_FLASHVAR_BPF_FILE ?= "bpmp_t264-TA1080SA-A1_prod.bin"
TEGRA_FLASHVAR_PMIC_CONFIG ?= "tegra264-mb1-bct-pmic-p3834-0005-p3971-0000.dts"
TEGRA_FLASHVAR_WB0SDRAM_BCT ?= "tegra264-p3834-0005-sdram-bct-warmboot-l4t.dts"
TEGRA_FLASHVAR_BPMP_MEM_CONFIG ?= "tegra264-p3834-0005-sdram-dfs.dts"

require conf/machine/include/agx-thor.inc
require conf/machine/include/devkit-wifi.inc
```

## conf/machine/p3834-0008-p3971-0000-nvme.conf
```bitbake
#@TYPE: Machine
#@NAME: Nvidia AGX Thor dev kit
#@DESCRIPTION: Nvidia AGX Thor dev kit (P3834-0008 module in P3971-0000 carrier with NVMe)

require conf/machine/include/agx-thor.inc
require conf/machine/include/devkit-wifi.inc
```

## conf/machine/p3834-0008-p3971-0000.conf
```bitbake
#@TYPE: Machine
#@NAME: Nvidia AGX Thor dev kit
#@DESCRIPTION: Nvidia AGX Thor dev kit (P3834-0008 module in P3971-0000 carrier with UFS)

TNSPEC_BOOTDEV ?= "block/a80b8d0000.ufshci:0"
PARTITION_LAYOUT_EXTERNAL_DEFAULT ?= "flash_l4t_t264_ufs.xml"
KERNEL_DEVICETREE ?= "tegra264-p3971-0089+p3834-0008-qspi-ufs.dtb"

TEGRA_FLASHVAR_UPHY_CONFIG ?= "tegra264-mb1-bct-uphy-lanes-kenari-l4t.dts"

ODMDATA ?= ""

require conf/machine/include/agx-thor.inc
require conf/machine/include/devkit-wifi.inc
```

## contrib/conf/layer.conf
```bitbake
BBPATH .= ":${LAYERDIR}"
BBFILES += " \
    ${LAYERDIR}/recipes-*/*/*.bb \
    ${LAYERDIR}/recipes-*/*/*.bbappend \
"

BBFILE_COLLECTIONS += "tegra-contrib"
BBFILE_PATTERN_tegra-contrib = "^${LAYERDIR}/"
BBFILE_PRIORITY_tegra-contrib = "6"

LAYERVERSION_tegra-contrib = "1"

LAYERDEPENDS_tegra-contrib = "core"

LAYERSERIES_COMPAT_tegra-contrib = "dunfell"
```
