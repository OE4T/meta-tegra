## conf/layer.conf
```bitbake
BBPATH .= ":${LAYERDIR}"
BBFILES += " \
    ${LAYERDIR}/recipes-*/*/*.bb \
    ${LAYERDIR}/recipes-*/*/*.bbappend \
"

BBFILE_COLLECTIONS += "tegra"
BBFILE_PATTERN_tegra = "^${LAYERDIR}/"
BBFILE_PRIORITY_tegra = "5"

LAYERVERSION_tegra = "1"

LAYERDEPENDS_tegra = "core"

LAYERSERIES_COMPAT_tegra = "whinlatter"

# Recipe modifications for other layers that may be included in the build
BBFILES += "${@' '.join('${LAYERDIR}/external/%s/recipes*/*/*.bb' % layer \
               for layer in BBFILE_COLLECTIONS.split() if os.path.exists(os.path.join('${LAYERDIR}','external',layer)))}"
BBFILES += "${@' '.join('${LAYERDIR}/external/%s/recipes*/*/*.bbappend' % layer \
               for layer in BBFILE_COLLECTIONS.split() if os.path.exists(os.path.join('${LAYERDIR}','external',layer)))}"

SIGGEN_EXCLUDE_SAFE_RECIPE_DEPS += "\
  gcc-for-nvcc-cross-${TARGET_ARCH}->linux-libc-headers \
"

addpylib ${LAYERDIR}/lib oe4t
```

## conf/machine/clara-agx-xavier-devkit.conf
```bitbake
#@TYPE: Machine
#@NAME: NVIDIA Clara AGX Devkit
#@DESCRIPTION: NVIDIA Clara AGX Developer Kit

require conf/machine/include/tegra194.inc

# Extracted from jetson_board_spec.cfg for BOARDID=2888 and board=clara-agx-xavier-devkit
TEGRA_BUPGEN_SPECS ?= "fab=400;boardsku=0004;boardrev="

KERNEL_DEVICETREE ?= "tegra194-p2888-0004-e3900-0000.dtb"
KERNEL_ARGS ?= "mminit_loglevel=4 console=tty0 console=ttyTCU0,115200 fbcon=map:0 sdhci_tegra.en_boot_part_access=1"

EMMC_SIZE ?= "31276924928"
EMMC_DEVSECT_SIZE ?= "512"
BOOTPART_SIZE ?= "8388608"
BOOTPART_LIMIT ?= "10485760"
ROOTFSPART_SIZE_DEFAULT ?= "30064771072"
ODMDATA ?= "0x69190000"
EMMC_BCT ?= "tegra194-mb1-bct-memcfg-p2888.cfg"
EMMC_BCT_OVERRIDE ?= "tegra194-memcfg-sw-override.cfg"
NVIDIA_BOARD ?= "t186ref"
PARTITION_LAYOUT_TEMPLATE_DEFAULT ?= "flash_t194_sdmmc.xml"

TEGRA_AUDIO_DEVICE ?= "tegra-hda-jetson-agx"
```

## conf/machine/igx-orin-devkit.conf
```bitbake
#@TYPE: Machine
#@NAME: NVIDIA IGX Orin Devkit
#@DESCRIPTION: NVIDIA IGX Orin Developer Kit

NVPMODEL ?= "nvpmodel_p3701_0008_3740_0002"
NVFANCONTROL ?= "nvfancontrol_p3740_0002_c01"

require conf/machine/include/tegra234.inc
require conf/machine/include/devkit-wifi.inc

# Extracted from jetson_board_spec.cfg for BOARDID=3701 and board=igx-orin-devkit
TEGRA_BUPGEN_SPECS ?= "fab=000;boardsku=0008;boardrev="
KERNEL_DEVICETREE ?= "tegra234-p3740-0002+p3701-0008-nv.dtb"
KERNEL_ARGS ?= "mminit_loglevel=4 console=tty0 console=ttyTCU0,115200 firmware_class.path=/etc/firmware fbcon=map:0 net.ifnames=0 nospectre_bhb video=efifb:off console=tty0"

EMMC_SIZE ?= "31276924928"
EMMC_DEVSECT_SIZE ?= "512"
BOOTPART_SIZE ?= "8388608"
BOOTPART_LIMIT ?= "10485760"
ROOTFSPART_SIZE_DEFAULT ?= "30064771072"
ODMDATA ?= "gbe-uphy-config-8,hsio-uphy-config-0,nvhs-uphy-config-0"
EMMC_BCT ?= "tegra234-p3701-0008-sdram-l4t.dts"
NVIDIA_BOARD ?= "generic"
PARTITION_LAYOUT_TEMPLATE_DEFAULT ?= "flash_t234_qspi_sdmmc_safety.xml"
USE_REDUNDANT_FLASH_LAYOUT_DEFAULT ?= "0"
TEGRA_AUDIO_DEVICE ?= "tegra-hda-jetson-agx"

OTABOOTDEV ?= "/dev/mtdblock0"
OTAGPTDEV ?= "/dev/mtdblock0"

TEGRA_PLUGIN_MANAGER_OVERLAYS ?= "tegra234-carveouts.dtbo tegra-optee.dtbo"

TEGRA_FLASHVAR_BPFDTB_FILE = "tegra234-bpmp-3701-0008-3740-0002-c00.dtb"
TEGRA_FLASHVAR_BPF_FILE = "bpmp_t234-TA990SA-A1_prod.bin"
TEGRA_FLASHVAR_BR_CMD_CONFIG = "tegra234-mb1-bct-reset-p3701-0002-p3740-0002.dts"
TEGRA_FLASHVAR_DEVICEPROD_CONFIG = "tegra234-mb1-bct-cprod-p3701-0002-p3740-0002.dts"
TEGRA_FLASHVAR_DEVICE_CONFIG = "tegra234-mb1-bct-device-p3701-0002-p3740-0002.dts"
TEGRA_FLASHVAR_DEV_PARAMS = "tegra234-br-bct-p3701-0002-p3740-0002.dts"
TEGRA_FLASHVAR_DEV_PARAMS_B = "tegra234-br-bct_b-p3701-0002-p3740-0002.dts"
TEGRA_FLASHVAR_EMC_FUSE_DEV_PARAMS = "tegra234-br-bct-diag-boot.dts"
TEGRA_FLASHVAR_GPIOINT_CONFIG = "tegra234-mb1-bct-gpioint-p3701-0002-p3740-0002.dts"
TEGRA_FLASHVAR_MB2BCT_CFG = "tegra234-mb2-bct-misc-p3701-0002-p3740-0002.dts"
TEGRA_FLASHVAR_MINRATCHET_CONFIG = "--minratchet_config tegra234-mb1-bct-ratchet-p3701-0000.dts"
TEGRA_FLASHVAR_MISC_CONFIG = "tegra234-mb1-bct-misc-p3701-0008-flash.dts"
TEGRA_FLASHVAR_MISC_COLD_BOOT_CONFIG = "tegra234-mb1-bct-misc-p3701-0008-p3740-0002.dts"
TEGRA_FLASHVAR_PINMUX_CONFIG = "tegra234-mb1-bct-pinmux-p3701-0008-p3740-0002-c01.dtsi"
TEGRA_FLASHVAR_PMC_CONFIG = "tegra234-mb1-bct-padvoltage-p3701-0002-p3740-0002.dtsi"
TEGRA_FLASHVAR_PMIC_CONFIG = "tegra234-mb1-bct-pmic-p3701-0008-p3740-0002-c01.dts"
TEGRA_FLASHVAR_PROD_CONFIG = "tegra234-mb1-bct-prod-p3701-0002-p3740-0002.dts"
TEGRA_FLASHVAR_SCR_CONFIG = "tegra234-mb2-bct-firewall-si-p3701-0002-p3740-0002.dts"
TEGRA_FLASHVAR_UPHY_CONFIG = ""
TEGRA_FLASHVAR_WB0SDRAM_BCT = "tegra234-p3701-0008-wb0sdram-l4t.dts"
```

## conf/machine/include/agx-orin.inc
```bitbake
# Common settings for AGX Orin modules

require conf/machine/include/tegra234.inc

KERNEL_ARGS ?= "mminit_loglevel=4 console=tty0 console=ttyTCU0,115200 firmware_class.path=/etc/firmware fbcon=map:0 video=efifb:off console=tty0 efi=runtime nvme.use_threaded_interrupts=1 pci=pcie_bus_perf"

EMMC_DEVSECT_SIZE ?= "512"
BOOTPART_SIZE ?= "8388608"
BOOTPART_LIMIT ?= "10485760"
ROOTFSPART_SIZE_DEFAULT ?= "30064771072"
ODMDATA ?= "gbe-uphy-config-22,hsstp-lane-map-3,nvhs-uphy-config-0,hsio-uphy-config-0,gbe0-enable-10g"
EMMC_BCT ?= "tegra234-p3701-0000-sdram-l4t.dts"
PARTITION_LAYOUT_TEMPLATE_DEFAULT ?= "flash_t234_qspi_sdmmc.xml"
TEGRA_AUDIO_DEVICE ?= "tegra-hda-jetson-agx"

OTABOOTDEV ?= "/dev/mtdblock0"
OTAGPTDEV ?= "/dev/mtdblock0"

TEGRA_PLUGIN_MANAGER_OVERLAYS ?= "tegra234-p3737-0000+p3701-0000-dynamic.dtbo tegra234-carveouts.dtbo tegra-optee.dtbo tegra234-p3737-camera-dual-imx274-overlay.dtbo tegra234-p3737-camera-e3331-overlay.dtbo tegra234-p3737-camera-e3333-overlay.dtbo tegra234-p3737-camera-imx185-overlay.dtbo"

TEGRA_FLASHVAR_BPFDTB_FILE ?= "tegra234-bpmp-3701-0000-3737-0000.dtb"
TEGRA_FLASHVAR_BPF_FILE ?= "bpmp_t234-TE990M-A1_prod.bin"
TEGRA_FLASHVAR_BR_CMD_CONFIG ?= "tegra234-mb1-bct-reset-p3701-0000.dts"
TEGRA_FLASHVAR_CHIP_SKU ?= "00:00:00:D0"
TEGRA_FLASHVAR_DEVICEPROD_CONFIG ?= "tegra234-mb1-bct-cprod-p3701-0000.dts"
TEGRA_FLASHVAR_DEVICE_CONFIG ?= "tegra234-mb1-bct-device-p3701-0000.dts"
TEGRA_FLASHVAR_DEV_PARAMS ?= "tegra234-br-bct-p3701-0000.dts"
TEGRA_FLASHVAR_DEV_PARAMS_B ?= "tegra234-br-bct_b-p3701-0000.dts"
TEGRA_FLASHVAR_EMC_FUSE_DEV_PARAMS ?= "tegra234-br-bct-diag-boot.dts"
TEGRA_FLASHVAR_GPIOINT_CONFIG ?= "tegra234-mb1-bct-gpioint-p3701-0000.dts"
TEGRA_FLASHVAR_MB2BCT_CFG ?= "tegra234-mb2-bct-misc-p3701-0000.dts"
TEGRA_FLASHVAR_MINRATCHET_CONFIG ?= "--minratchet_config tegra234-mb1-bct-ratchet-p3701-0000.dts"
TEGRA_FLASHVAR_MISC_CONFIG ?= "tegra234-mb1-bct-misc-p3701-0000.dts"
TEGRA_FLASHVAR_PINMUX_CONFIG ?= "tegra234-mb1-bct-pinmux-p3701-0000-a04.dtsi"
TEGRA_FLASHVAR_PMC_CONFIG ?= "tegra234-mb1-bct-padvoltage-p3701-0000-a04.dtsi"
TEGRA_FLASHVAR_PMIC_CONFIG ?= "tegra234-mb1-bct-pmic-p3701-@PMICBOARDSKU@.dts"
TEGRA_FLASHVAR_PROD_CONFIG ?= "tegra234-mb1-bct-prod-p3701-0000.dts"
TEGRA_FLASHVAR_SCR_CONFIG ?= "tegra234-mb2-bct-scr-p3701-0000.dts"
TEGRA_FLASHVAR_UPHY_CONFIG ?= "--uphy tegra234-mb1-bct-uphylane-si.dtsi"
TEGRA_FLASHVAR_WB0SDRAM_BCT ?= "tegra234-p3701-0000-wb0sdram-l4t.dts"
```

## conf/machine/include/agx-xavier-uefi.inc
```bitbake
SERIAL_CONSOLES ?= "115200;ttyS0"

PREFERRED_PROVIDER_virtual/bootloader ?= "jetson-uefi-prebuilt"
PREFERRED_PROVIDER_virtual/kernel ?= "linux-tegra-upstream"

require conf/machine/include/tegra194.inc

MACHINE_ESSENTIAL_EXTRA_RDEPENDS = "linux-firmware-nvidia-tegra"
KERNEL_MODULE_AUTOLOAD = ""

KERNEL_ROOTSPEC ?= ""
KERNEL_DEVICETREE ?= "nvidia/tegra194-p2972-0000.dtb"
KERNEL_ARGS ?= "earlycon=uart8250,mmio32,0x3110000 console=ttyS0,115200n8 fbcon=map:0 ${KERNEL_ROOTSPEC}"

EMMC_SIZE ?= "31276924928"
EMMC_DEVSECT_SIZE ?= "512"
BOOTPART_SIZE ?= "8388608"
BOOTPART_LIMIT ?= "10485760"
ROOTFSPART_SIZE ?= "30064771072"
ODMDATA ?= "0x9190000"
EMMC_BCT ?= "tegra194-mb1-bct-memcfg-p2888.cfg"
EMMC_BCT_OVERRIDE ?= "tegra194-memcfg-sw-override.cfg"
NVIDIA_BOARD ?= "t186ref"
PARTITION_LAYOUT_TEMPLATE ?= "flash_t194_uefi_sdmmc.xml"

TEGRA_INITRD_FIRMWARE ?= "linux-firmware-nvidia-tegra"
```

## conf/machine/include/agx-xavier.inc
```bitbake
require conf/machine/include/tegra194.inc

KERNEL_ARGS ?= "mminit_loglevel=4 console=tty0 console=ttyTCU0,115200 fbcon=map:0 video=efifb:off"

EMMC_SIZE ?= "31276924928"
EMMC_DEVSECT_SIZE ?= "512"
BOOTPART_SIZE ?= "8388608"
BOOTPART_LIMIT ?= "10485760"
ROOTFSPART_SIZE_DEFAULT ?= "30064771072"
ODMDATA ?= "0x9190000"

EMMC_BCT_OVERRIDE ?= "tegra194-memcfg-sw-override.cfg"
NVIDIA_BOARD ?= "t186ref"

TEGRA_AUDIO_DEVICE ?= "tegra-hda-jetson-agx"
```

## conf/machine/include/devkit-audio.inc
```bitbake
MACHINE_EXTRA_RRECOMMENDS += " \
    kernel-module-tegra-aconnect \
    kernel-module-tegra210-adma \
    kernel-module-snd-soc-rl6231 \
    kernel-module-snd-soc-rt5640 \
    kernel-module-snd-soc-tegra-audio-graph-card \
    kernel-module-snd-soc-tegra210-ahub \
    kernel-module-snd-soc-tegra210-admaif \
    kernel-module-snd-soc-tegra210-i2s \
    kernel-module-snd-soc-tegra210-dmic \
    kernel-module-snd-soc-tegra210-mixer \
    kernel-module-snd-soc-tegra210-amx \
    kernel-module-snd-soc-tegra210-adx \
    kernel-module-snd-soc-tegra210-mvc \
    kernel-module-snd-soc-tegra210-sfc \
    kernel-module-snd-soc-tegra210-ope \
    kernel-module-snd-soc-tegra186-asrc \
    kernel-module-snd-soc-tegra186-dspk \
    nvidia-kernel-oot-alsa \
"
```

## conf/machine/include/igx-orin.inc
```bitbake
# Common settings for IGX Orin modules

NVPMODEL ?= "nvpmodel_p3701_0008"
NVFANCONTROL ?= "nvfancontrol_p3701_0008"
TEGRA_EDK2_CONFIGURATION ?= "general_igx"

require conf/machine/include/tegra234.inc

KERNEL_ARGS ?= "mminit_loglevel=4 console=tty0 console=ttyTCU0,115200 firmware_class.path=/etc/firmware fbcon=map:0 video=efifb:off console=tty0 efi=runtime nvme.use_threaded_interrupts=1 pci=pcie_bus_safe"

EMMC_DEVSECT_SIZE ?= "512"
BOOTPART_SIZE ?= "8388608"
BOOTPART_LIMIT ?= "10485760"
ROOTFSPART_SIZE_DEFAULT ?= "55834574848"
TEGRA_FLASHVAR_ODMDATA ?= "gbe-uphy-config-8,hsio-uphy-config-0,nvhs-uphy-config-0"
EMC_BCT ?= "tegra234-p3701-0008-sdram-l4t.dts"
PARTITION_LAYOUT_TEMPLATE_DEFAULT ?= "flash_t234_qspi_sdmmc_safety.xml"
TEGRA_AUDIO_DEVICE ?= "tegra-hda-jetson-agx"

OTABOOTDEV ?= "/dev/mtdblock0"
OTAGPTDEV ?= "/dev/mtdblock0"

TEGRA_PLUGIN_MANAGER_OVERLAYS ?= "tegra234-carveouts.dtbo tegra-optee.dtbo"

TEGRA_FLASHVAR_BPFDTB_FILE ?= "tegra234-bpmp-3701-0008-3740-0002-c00.dtb"
TEGRA_FLASHVAR_BPF_FILE ?= "bpmp_t234-TA990SA-A1_prod.bin"
TEGRA_FLASHVAR_BR_CMD_CONFIG ?= "tegra234-mb1-bct-reset-p3701-0002-p3740-0002.dts"
TEGRA_FLASHVAR_CHIP_SKU ?= "00:00:00:D0"
TEGRA_FLASHVAR_DEVICEPROD_CONFIG ?= "tegra234-mb1-bct-cprod-p3701-0002-p3740-0002.dts"
TEGRA_FLASHVAR_DEVICE_CONFIG ?= "tegra234-mb1-bct-device-p3701-0002-p3740-0002.dts"
TEGRA_FLASHVAR_DEV_PARAMS ?= "tegra234-br-bct-p3701-0002-p3740-0002.dts"
TEGRA_FLASHVAR_DEV_PARAMS_B ?= "tegra234-br-bct_b-p3701-0002-p3740-0002.dts"
TEGRA_FLASHVAR_EMC_FUSE_DEV_PARAMS ?= "tegra234-br-bct-diag-boot.dts"
TEGRA_FLASHVAR_FSIFW ?= "fsi-lk.bin"
TEGRA_FLASHVAR_GPIOINT_CONFIG ?= "tegra234-mb1-bct-gpioint-p3701-0002-p3740-0002.dts"
TEGRA_FLASHVAR_MB2BCT_CFG ?= "tegra234-mb2-bct-misc-p3701-0002-p3740-0002.dts"
TEGRA_FLASHVAR_MINRATCHET_CONFIG ?= "--minratchet_config tegra234-mb1-bct-ratchet-p3701-0000.dts"
TEGRA_FLASHVAR_MISC_CONFIG ?= "tegra234-mb1-bct-misc-p3701-0008-flash.dts"
TEGRA_FLASHVAR_PINMUX_CONFIG ?= "tegra234-mb1-bct-pinmux-p3701-0008-p3740-0002-c01.dtsi"
TEGRA_FLASHVAR_PMC_CONFIG ?= "tegra234-mb1-bct-padvoltage-p3701-0002-p3740-0002.dtsi"
TEGRA_FLASHVAR_PMIC_CONFIG ?= "tegra234-mb1-bct-pmic-p3701-0008-p3740-0002-c01.dts"
TEGRA_FLASHVAR_PROD_CONFIG ?= "tegra234-mb1-bct-prod-p3701-0002-p3740-0002.dts"
TEGRA_FLASHVAR_SCR_CONFIG ?= "tegra234-mb2-bct-firewall-si-p3701-0002-p3740-0002.dts"
TEGRA_FLASHVAR_UPHY_CONFIG ?= ""
TEGRA_FLASHVAR_WB0SDRAM_BCT ?= "tegra234-p3701-0008-wb0sdram-l4t.dts"
```

## conf/machine/include/igx-thor-t5000.inc
```bitbake
# Common settings for IGX Thor T5000 (p3834-0008) modules

TEGRA_BOARDID ?= "3834"
TEGRA_FAB ?= "400"
TEGRA_BOARDSKU ?= "0008"
TEGRA_BOARDREV ?= "G.5"
TEGRA_CHIPREV ?= "1"
NVPMODEL ?= "nvpmodel_p3834_0008"
NVFANCONTROL ?= "nvfancontrol_p3834_0008_p3740_0002"

TNSPEC_BOOTDEV ?= "nvme0n1p1"
PARTITION_LAYOUT_TEMPLATE_DEFAULT ?= "flash_l4t_t264_qspi.xml"
PARTITION_LAYOUT_TEMPLATE_DEFAULT_SUPPORTS_REDUNDANT ?= "1"
PARTITION_LAYOUT_EXTERNAL_DEFAULT ?= "flash_l4t_t264_nvme.xml"
TEGRAFLASH_NO_INTERNAL_STORAGE = "1"

TEGRA_BUPGEN_SPECS ?= " \
    fab=000;boardsku=0008;boardrev=;chiprev=;chipsku=00:00:00:A0;bup_type=bl \
    fab=401;boardsku=0008;boardrev=;chiprev=;chipsku=00:00:00:A0;bup_type=bl \
"

EMMC_SIZE ?= ""
BOOTPART_SIZE ?= ""

TEGRA_PLUGIN_MANAGER_OVERLAYS ?= ""
TEGRA_FLASHVAR_BPFDTB_FILE ?= "tegra264-bpmp-3834-0008-3740-xxxx.dtb"
TEGRA_FLASHVAR_BPF_FILE ?= "bpmp_t264-TA1090SA-A1_prod.bin"
TEGRA_FLASHVAR_CHIP_SKU ?= "00:00:00:A0"
TEGRA_FLASHVAR_DEVICEPROD_CONFIG ?= "tegra264-mb1-bct-cprod-p3834-xxxx-p3971-0000.dts"
TEGRA_FLASHVAR_DEVICE_CONFIG ?= "tegra264-mb1-bct-device-p3834-xxxx.dts"
TEGRA_FLASHVAR_DEV_PARAMS ?= "tegra264-br-bct-common-l4t.dts"
TEGRA_FLASHVAR_DEV_PARAMS_B ?= ""
TEGRA_FLASHVAR_EMC_FUSE_DEV_PARAMS ?= "tegra264-br-bct-diag-boot.dts"
TEGRA_FLASHVAR_FSIFW ?= "fsi-fw-t264.bin"
TEGRA_FLASHVAR_GPIOINT_CONFIG ?= "tegra264-mb1-bct-gpioint-p3834-xxxx-p3971-0000.dts"
TEGRA_FLASHVAR_MB2BCT_CFG ?= "tegra264-mb2-bct-misc-p3834-0008-p3740-0002.dts"
TEGRA_FLASHVAR_MINRATCHET_CONFIG ?= "tegra264-mb1-bct-ratchet-p3834-xxxx-p3971-0000.dts"
TEGRA_FLASHVAR_MISC_CONFIG ?= "tegra264-mb1-bct-misc-p3834-xxxx-p3971-0000.dts"
TEGRA_FLASHVAR_PINMUX_CONFIG ?= "tegra264-mb1-bct-pinmux-p3834-0008-p3740-0002.dts"
TEGRA_FLASHVAR_PMC_CONFIG ?= "tegra264-mb1-bct-padvoltage-p3834-0008-p3740-0002.dts"
TEGRA_FLASHVAR_PMIC_CONFIG ?= "tegra264-mb1-bct-pmic-p3834-0008-p3740-0002.dts"
TEGRA_FLASHVAR_PROD_CONFIG ?= "tegra264-mb1-bct-prod-p3834-xxxx-p3971-0000.dts"
TEGRA_FLASHVAR_RAMCODE ?= "12"
TEGRA_FLASHVAR_SCR_CONFIG ?= "tegra264-mb2-bct-firewall-p3834-xxxx-p3971-0000.dts"
TEGRA_FLASHVAR_UPHY_CONFIG ?= ""
TEGRA_FLASHVAR_WB0SDRAM_BCT ?= "tegra264-p3834-0008-sdram-bct-warmboot-l4t.dts"
TEGRA_FLASHVAR_BPMP_MEM_CONFIG ?= "tegra264-p3834-0008-sdram-dfs.dts"

TEGRA_EDK2_CONFIGURATION ?= "general_igx"

require conf/machine/include/tegra264.inc

MACHINE_EXTRA_RRECOMMENDS += "kernel-module-r8126 kernel-module-8168 kernel-module-8169 kernel-module-realtek kernel-module-ina238"
MACHINE_EXTRA_RRECOMMENDS += "kernel-module-ramoops kernel-module-tsecriscv"
MACHINE_EXTRA_RDEPENDS += "linux-firmware-rtl8168"

KERNEL_DEVICETREE ?= "tegra264-p3740-0002+p3834-0008-qspi-nvme.dtb"
# 50GiB default rootfs size
ROOTFSPART_SIZE_DEFAULT ?= "53687091200"
TEGRA_FLASHVAR_ODMDATA ?= "uphy0-config-6,pcie@3_status=okay"
EMC_BCT ?= "tegra264-p3834-0008-sdram-bct-l4t.dts"
TEGRA_AUDIO_DEVICE ?= "tegra-hda-p3767-p3509"

OTABOOTDEV ?= "/dev/mtdblock0"
OTAGPTDEV ?= "/dev/mtdblock0"
```
