## conf/machine/jetson-agx-xavier-industrial.conf
```bitbake
#@TYPE: Machine
#@NAME: Nvidia Jetson Xavier Industrial
#@DESCRIPTION: Nvidia Jetson Xavier Industrial module on devkit board

require conf/machine/include/agx-xavier.inc

KERNEL_DEVICETREE ?= "tegra194-p2888-0008-p2822-0000.dtb"

EMMC_BCT ?= "tegra194-mb1-bct-memcfg-4x-derated-ecc-p2888.cfg"

PARTITION_LAYOUT_TEMPLATE_DEFAULT ?= "flash_l4t_t194_spi_emmc_jaxi.xml"
TEGRA_PLUGIN_MANAGER_OVERLAYS ?= "${TEGRA_BOOTCONTROL_OVERLAYS} tegra194-p2822-camera-dual-imx274-overlay.dtbo tegra194-p2822-camera-e3326-overlay.dtbo tegra194-p2822-camera-e3331-overlay.dtbo tegra194-p2822-camera-e3333-overlay.dtbo tegra194-p2822-camera-imx185-overlay.dtbo tegra194-p2822-camera-imx390-overlay.dtbo tegra194-p2888-0005-overlay.dtbo tegra194-p2888-0001-p2822-0000-overlay.dtbo"

OTA_BOOT_DEVICE ?= "/dev/mtdblock0"
OTA_GPT_DEVICE ?= "/dev/mtdblock0"

TEGRA_FLASHVAR_BPFDTB_FILE ?= "tegra194-a02-bpmp-p2888-0008-b01-jaxi_lz4.dtb"
TEGRA_FLASHVAR_BR_CMD_CONFIG ?= "tegra194-mb1-bct-reset-p2888-0000-p2822-0000.cfg"
TEGRA_FLASHVAR_DEVICE_CONFIG ?= "tegra19x-mb1-bct-device-qspi-jaxi.cfg"
TEGRA_FLASHVAR_DEV_PARAMS ?= "tegra194-br-bct-qspi-l4t.cfg"
TEGRA_FLASHVAR_DEV_PARAMS_B ?= "tegra194-br-bct_b-qspi-l4t.cfg"
TEGRA_FLASHVAR_GPIOINT_CONFIG ?= "tegra194-mb1-bct-gpioint-p2888-0000-p2822-0000.cfg"
TEGRA_FLASHVAR_MINRATCHET_CONFIG ?= "--minratchet_config tegra194-mb1-bct-ratchet-p2888-0000-p2822-0000.cfg"
TEGRA_FLASHVAR_MISC_COLD_BOOT_CONFIG ?= "tegra194-mb1-bct-misc-l4t-jaxi.cfg"
TEGRA_FLASHVAR_MISC_CONFIG ?= "tegra194-mb1-bct-misc-flash-jaxi.cfg"
TEGRA_FLASHVAR_PINMUX_CONFIG ?= "tegra19x-mb1-pinmux-p2888-0008-b01-p2822-0000-jaxi.cfg"
TEGRA_FLASHVAR_PMC_CONFIG ?= "tegra19x-mb1-padvoltage-p2888-0000-a00-p2822-0000-a00.cfg"
TEGRA_FLASHVAR_PMIC_CONFIG ?= "tegra194-mb1-bct-pmic-p2888-0008-b01-p2822-0000.cfg"
TEGRA_FLASHVAR_PROD_CONFIG ?= "tegra19x-mb1-prod-p2888-0000-p2822-0000.cfg"
TEGRA_FLASHVAR_RAMCODE ?= "1"
TEGRA_FLASHVAR_SCR_COLD_BOOT_CONFIG ?= "tegra194-mb1-bct-scr-cbb-mini.cfg"
TEGRA_FLASHVAR_SCR_CONFIG ?= "tegra194-mb1-bct-scr-cbb-mini.cfg"
TEGRA_FLASHVAR_UPHY_CONFIG ?= "--uphy_config tegra194-mb1-uphy-lane-p2888-0000-p2822-0000.cfg"
```

## conf/machine/jetson-igx-orin-devkit.conf
```bitbake
#@TYPE: Machine
#@NAME: Nvidia Jetson IGX Orin dev kit
#@DESCRIPTION: Nvidia Jetson IGX Orin dev kit (P3701-0008 module in P3740-0002 carrier)

TEGRA_BUPGEN_SPECS ?= "fab=300;boardsku=0008;boardrev=;chipsku=00:00:00:D0;bup_type=bl \
                       fab=300;boardsku=0008;boardrev=;bup_type=kernel"
KERNEL_DEVICETREE ?= "tegra234-p3740-0002+p3701-0008-nv.dtb"

require conf/machine/include/igx-orin.inc
require conf/machine/include/devkit-wifi.inc
require conf/machine/include/devkit-audio.inc
```

## conf/machine/jetson-igx-thor-devkit.conf
```bitbake
#@TYPE: Machine
#@NAME: Nvidia IGX Thor dev kit
#@DESCRIPTION: Nvidia IGX Thor dev kit (P3834-0008 module in P3740-0002 carrier with NVMe)

require conf/machine/include/igx-thor-t5000.inc

NVIDIA_WIFI ?= "kernel-module-rtk-btusb kernel-module-rtl8852ce"
require conf/machine/include/devkit-wifi.inc
require conf/machine/include/devkit-audio.inc
```
