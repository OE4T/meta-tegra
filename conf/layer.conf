## conf/machine/include/tegra186.inc
```bitbake
# Settings common to all Tegra X2 (tegra186) SoCs

SOC_FAMILY = "tegra186"

require conf/machine/include/soc-family.inc
require conf/machine/include/arm/arch-armv8a.inc

KERNEL_IMAGETYPE ?= "${@'Image.gz' if d.getVar('PREFERRED_PROVIDER_virtual/bootloader').startswith('cboot') else 'Image'}"
KERNEL_ARGS ?= "console=ttyS0,115200 console=tty0 fbcon=map:0 isolcpus=1-2"

TEGRA_ESSENTIAL_EXTRA_RDEPENDS = "${@'' if d.getVar('PREFERRED_PROVIDER_virtual/bootloader').startswith('cboot') else 'kernel-image u-boot-extlinux'}"

INITRAMFS_IMAGE ?= "tegra-minimal-initramfs"
INITRAMFS_IMAGE_BUNDLE ?= "${@'1' if d.getVar('PREFERRED_PROVIDER_virtual/bootloader').startswith('cboot') else ''}"
IMAGE_UBOOT ?= "${@'' if d.getVar('PREFERRED_PROVIDER_virtual/bootloader').startswith('cboot') else 'u-boot'}"
TEGRA_INITRAMFS_FSTYPES ?= "${@'' if not (d.getVar('PREFERRED_PROVIDER_virtual/bootloader').startswith('cboot') and d.getVar('INITRAMFS_IMAGE_BUNDLE') != '1') else ' cpio.gz.cboot cpio.gz.cboot.bup-payload'}"

TEGRA_AUDIO_DEVICE ?= "tegrahda"

SERIAL_CONSOLES ?= "115200;ttyS0"

NVIDIA_CHIP = "0x18"

TEGRA_SIGNING_ENV ?= "BOARDID=${TEGRA_BOARDID} FAB=${TEGRA_FAB}"

TEGRA_CUDA_ARCHITECTURE ?= "62"

PREFERRED_PROVIDER_tos-trusty ?= "tos-prebuilt"
PREFERRED_PROVIDER_cboot ?= "cboot-t18x"

require conf/machine/include/tegra-common.inc

L4T_BSP_NAME = "T186"
L4T_BSP_PREFIX = "Jetson"
L4T_DEB_SOCNAME = "t186"

NVPMODEL ?= "nvpmodel_t186"

PARTITION_LAYOUT_EXTERNAL ?= "flash_l4t_nvme.xml"
BOOT_PARTITIONS_ON_EMMC = "1"
```

## conf/machine/include/tegra194.inc
```bitbake
# Settings common to all Xavier (tegra194) SoCs

SOC_FAMILY = "tegra194"

require conf/machine/include/soc-family.inc
DEFAULTTUNE ?= "armv8a-crc"
require conf/machine/include/arm/arch-armv8-2a.inc

SERIAL_CONSOLES ?= "115200;ttyTCU0"

KERNEL_MODULE_AUTOLOAD ?= "nvmap nvgpu pwm-fan ina3221 tegra-udrm"

NVIDIA_CHIP = "0x19"

TEGRA_BOARDID ?= "2888"
TEGRA_FAB ?= "400"
TEGRA_BOARDSKU ?= "0001"
TEGRA_BOARDREV ?= "H.0"
TEGRA_CHIPREV ?= "2"

TEGRA_CUDA_ARCHITECTURE ?= "72"

require conf/machine/include/tegra-common.inc

L4T_BSP_PREFIX = "Jetson"
L4T_DEB_SOCNAME = "t194"

NVPMODEL ?= "nvpmodel_t194"
NVPOWER ?= "jetsonpower_t194"
NVFANCONTROL ?= "nvfancontrol_p2888"

MACHINE_EXTRA_RRECOMMENDS += "kernel-module-tegra-udrm"

KERNEL_MODULE_PROBECONF += "tegra-udrm"
module_conf_tegra-udrm = "options tegra-udrm modeset=1"

PARTITION_LAYOUT_EXTERNAL_DEFAULT ?= "flash_l4t_nvme.xml"

TEGRA_BOOT_FIRMWARE_FILES = "\
    adsp-fw.bin \
    bpmp-2_t194.bin \
    camera-rtcpu-t194-rce.img \
    dram-ecc-t194.bin \
    mb1_t194_prod.bin \
    nvdisp-init.bin \
    nvtboot_applet_t194.bin \
    nvtboot_t194.bin \
    preboot_c10_prod_cr.bin \
    mce_c10_prod_cr.bin \
    mts_c10_prod_cr.bin \
    nvtboot_cpu_t194.bin \
    nvtboot_recovery_t194.bin \
    nvtboot_recovery_cpu_t194.bin \
    spe_t194.bin \
    xusb_sil_rel_fw \
    warmboot_t194_prod.bin \
    sce_t194.bin \
    dram-ecc-t194.bin \
"
```

## conf/machine/include/tegra210.inc
```bitbake
# Settings common to all Tegra X1 (tegra210) SoCs

SOC_FAMILY = "tegra210"

KERNEL_IMAGETYPE ?= "Image"
KERNEL_IMAGETYPES ?= "${KERNEL_IMAGETYPE}"

require conf/machine/include/soc-family.inc
require conf/machine/include/arm/arch-armv8a.inc

TEGRA_ESSENTIAL_EXTRA_RDEPENDS = "${@'' if d.getVar('PREFERRED_PROVIDER_virtual/bootloader').startswith('cboot') else 'kernel-image u-boot-extlinux'}"

INITRAMFS_IMAGE ?= "tegra-minimal-initramfs"
IMAGE_UBOOT ?= "${@'' if d.getVar('PREFERRED_PROVIDER_virtual/bootloader').startswith('cboot') else 'u-boot'}"
TEGRA_INITRAMFS_FSTYPES ?= "${@'' if not (d.getVar('PREFERRED_PROVIDER_virtual/bootloader').startswith('cboot') and d.getVar('INITRAMFS_IMAGE_BUNDLE') != '1') else ' cpio.gz.cboot'}"

TEGRA_AUDIO_DEVICE ?= "tegrahda"

SERIAL_CONSOLES ?= "115200;ttyS0"

KERNEL_MODULE_AUTOLOAD = "nvgpu"

KERNEL_ARGS ?= "sdhci_tegra.en_boot_part_access=1"

NVIDIA_CHIP = "0x21"

TEGRA_SIGNING_ENV ?= "BOARDID=${TEGRA_BOARDID} FAB=${TEGRA_FAB} BOARDSKU=${TEGRA_BOARDSKU} BOARDREV=${TEGRA_BOARDREV}"

TEGRA_CUDA_ARCHITECTURE ?= "53"

require conf/machine/include/tegra-common.inc

L4T_BSP_NAME = "T210"
L4T_BSP_PREFIX = "Jetson-210"
L4T_DEB_SOCNAME = "t210"
L4T_BSP_ARCH = "tegra210"
L4T_BSP_PKGARCH = "${SOC_FAMILY_PKGARCH}"

NVPMODEL ?= "nvpmodel_t210"
TEGRA_BOARDID ?= "2180"
TEGRA_FAB ?= "100"
TEGRA_BOARDSKU ?= ""
TEGRA_BOARDREV ?= ""
TEGRA_CHIPREV ?= "0"

PARTITION_LAYOUT_EXTERNAL ?= "external_layout.xml"
BOOT_PARTITIONS_ON_EMMC = "1"
```

## conf/machine/include/tegra234.inc
```bitbake
# Settings common to all Orin (tegra234) SoCs

SOC_FAMILY = "tegra234"

require conf/machine/include/soc-family.inc
DEFAULTTUNE ?= "armv8a-crc"
require conf/machine/include/arm/arch-armv8-2a.inc

SERIAL_CONSOLES ?= "115200;ttyTCU0"

KERNEL_MODULE_AUTOLOAD ?= "nvmap nvgpu pwm-fan ina3221"

NVIDIA_CHIP = "0x23"

TEGRA_BOARDID ?= "3701"
TEGRA_FAB ?= "TS4"
TEGRA_BOARDSKU ?= "0000"
TEGRA_BOARDREV ?= "C.0"
TEGRA_CHIPREV ?= "0"
TEGRA_CUDA_ARCHITECTURE ?= "87"

require conf/machine/include/tegra-common.inc

L4T_BSP_PREFIX = "Jetson"
L4T_DEB_SOCNAME = "t234"

NVPMODEL ?= "nvpmodel_p3701_0000"
NVPOWER ?= "jetsonpower_t234"
NVFANCONTROL ?= "nvfancontrol_p3701_0000"

PARTITION_LAYOUT_EXTERNAL_DEFAULT ?= "flash_l4t_t234_nvme.xml"

TEGRA_BOOT_FIRMWARE_FILES = "\
    adsp-fw.bin \
    applet_t234.bin \
    camera-rtcpu-t234-rce.img \
    mb1_t234_prod.bin \
    mb2_t234.bin \
    mb2rf_t234.bin \
    preboot_c10_prod_cr.bin \
    mce_c10_prod_cr.bin \
    mts_c10_prod_cr.bin \
    spe_t234.bin \
    psc_bl1_t234_prod.bin \
    pscfw_t234_prod.bin \
    mce_flash_o10_cr_prod.bin \
    sc7_t234_prod.bin \
    display-t234-dce.bin \
    psc_rf_t234_prod.bin \
    nvdec_t234_prod.fw \
    xusb_t234_prod.bin \
    tegrabl_carveout_id.h \
    pinctrl-tegra.h \
    tegra234-gpio.h \
    readinfo_t234_min_prod.xml \
    fsi-fw-ecc.bin \
    nvpva_020.fw \
    tsec_t234.bin \
"
```

## conf/machine/include/tegra264.inc
```bitbake
# Settings common to all Thor (tegra264) SoCs

SOC_FAMILY = "tegra264"

require conf/machine/include/soc-family.inc

# t264 uses Neoverse V3AE cores, but default to
# generic aarch64 to match how Jetson Linux/Ubuntu
# libraries are built
DEFAULTTUNE ?= "aarch64"
require conf/machine/include/arm/arch-armv9a.inc

SERIAL_CONSOLES ?= "115200;ttyUTC0"

KERNEL_MODULE_AUTOLOAD ?= "nvmap pwm-fan ina3221"
KERNEL_ARGS ?= "mminit_loglevel=4 earlycon=tegra_utc,mmio32,0xc5a0000 console=ttyUTC0,115200 clk_ignore_unused firmware_class.path=/etc/firmware fbcon=map:0 efi=runtime"

NVIDIA_CHIP = "0x26"

TEGRA_BOARDID ?= "3834"
TEGRA_FAB ?= "400"
TEGRA_BOARDSKU ?= "0008"
TEGRA_BOARDREV ?= "G.5"
TEGRA_CHIPREV ?= "1"
TEGRA_CUDA_ARCHITECTURE ?= "110"

TEGRA_FLASHVAR_BR_CMD_CONFIG ?= ""

require conf/machine/include/tegra-common.inc

L4T_BSP_PREFIX = "Jetson"
L4T_DEB_SOCNAME = "som"

NVPMODEL ?= "nvpmodel_p3834_0008"
NVPOWER ?= "jetsonpower_t264"
NVFANCONTROL ?= "nvfancontrol_p3834_0008_p4071_0000"

PARTITION_LAYOUT_EXTERNAL_DEFAULT ?= "flash_l4t_t264_nvme.xml"
PARTITION_LAYOUT_RCMBOOT_DEFAULT ?= "flash_l4t_t264_rcmboot.xml"

TEGRA_BOOT_FIRMWARE_FILES = "\
    adsp-fw.bin \
    applet_t264.bin \
    camera-rtcpu-t264-rce.img \
    mb1_t264_prod.bin \
    mb2_t264.bin \
    mb2rf_t264.bin \
    bl31_t264.fip \
    psc_bl1_t264_prod.bin \
    hpse_bl1_t264_prod.bin \
    sb_bl1_t264_prod.bin \
    hpsefw_t264_prod.bin \
    sbfw_t264_prod.bin \
    pscfw_t264_prod.bin \
    hpseraw_t264_prod.bin \
    sbraw_t264_prod.bin \
    tsec_t264_prod.bin \
    sc7_t264_prod.bin \
    display-t264-dce.bin \
    nv-rce1-t264.bin \
    aon-fw_t264.bin \
    adsp0-fw_t264.bin \
    adsp1-fw_t264.bin \
    xusb_t264_prod.bin \
    igbfw_gb10b_gsc_package_prod.bin \
    nvpva_030.fw \
    spvault-hpse-oem-conf.bin \
    spvault-sb-oem-conf.bin \
    readinfo_t264_min_prod.xml \
    flash_l4t_t264_bct_cfg.xml \
"

PREFERRED_PROVIDER_hafnium ?= "hafnium"
PREFERRED_VERSION_hafnium ?= "2.9-l4t%"
```

## conf/machine/include/xavier-nx.inc
```bitbake
# Common settings for Xavier NX modules and P3509 carriers
# (with PCI WiFi/USB Bluetooth). Should also be compatible
# with P3489 carriers.

TEGRA_BOARDID ?= "3668"
TEGRA_FAB ?= "200"
TEGRA_BOARDREV ?= "G.0"
TEGRA_CHIPREV ?= "2"
NVPMODEL ?= "nvpmodel_t194_p3668"
NVFANCONTROL ?= "nvfancontrol_p3668"
TEGRA_AUDIO_DEVICE ?= "tegra-hda-jetson-xnx"

MACHINEOVERRIDES =. "xavier-nx:"
require conf/machine/include/tegra194.inc

KERNEL_DEVICETREE ?= "tegra194-p3668-all-p3509-0000.dtb"
KERNEL_ARGS ?= "console=ttyTCU0,115200 console=tty0 fbcon=map:0 video=efifb:off"

EMMC_DEVSECT_SIZE ?= "512"
BOOTPART_SIZE ?= ""
BOOTPART_LIMIT ?= "10485760"
ROOTFSPART_SIZE_DEFAULT ?= "15032385536"
RECROOTFSSIZE ?= "104857600"
ODMDATA ?= "0xB8190000"
EMMC_BCT ?= "tegra194-mb1-bct-memcfg-p3668-0001-a00.cfg"
EMMC_BCT_OVERRIDE ?= "tegra194-memcfg-sw-override.cfg"
NVIDIA_BOARD ?= "t186ref"
TEGRA_PLUGIN_MANAGER_OVERLAYS ?= "tegra194-p3668-p3509-overlay.dtbo"

OTABOOTDEV ?= "/dev/mtdblock0"
OTAGPTDEV ?= "/dev/mtdblock0"

TEGRA_AUDIO_DEVICE ?= "tegra-hda-jetson-xnx"

TEGRA_FLASHVAR_BPFDTB_FILE ?= "tegra194-a02-bpmp-p3668-a00_lz4.dtb"
TEGRA_FLASHVAR_BR_CMD_CONFIG ?= "tegra194-mb1-bct-reset-p3668-0001-a00.cfg"
TEGRA_FLASHVAR_DEVICE_CONFIG ?= "tegra19x-mb1-bct-device-qspi-p3668.cfg"
TEGRA_FLASHVAR_DEV_PARAMS ?= "tegra194-br-bct-qspi-l4t.cfg"
TEGRA_FLASHVAR_DEV_PARAMS_B ?= "tegra194-br-bct_b-qspi-l4t.cfg"
TEGRA_FLASHVAR_GPIOINT_CONFIG ?= "tegra194-mb1-bct-gpioint-p3668-0001-a00.cfg"
TEGRA_FLASHVAR_MINRATCHET_CONFIG ?= "--minratchet_config tegra194-mb1-bct-ratchet-p3668.cfg"
TEGRA_FLASHVAR_MISC_COLD_BOOT_CONFIG ?= "tegra194-mb1-bct-misc-l4t.cfg"
TEGRA_FLASHVAR_MISC_CONFIG ?= "tegra194-mb1-bct-misc-flash.cfg"
TEGRA_FLASHVAR_PINMUX_CONFIG ?= "tegra19x-mb1-pinmux-p3668-a01.cfg"
TEGRA_FLASHVAR_PMC_CONFIG ?= "tegra19x-mb1-padvoltage-p3668-a01.cfg"
TEGRA_FLASHVAR_PMIC_CONFIG ?= "tegra194-mb1-bct-pmic-p3668-0001-a00.cfg"
TEGRA_FLASHVAR_PROD_CONFIG ?= "tegra19x-mb1-prod-p3668-0001-a00.cfg"
TEGRA_FLASHVAR_SCR_COLD_BOOT_CONFIG ?= "tegra194-mb1-bct-scr-cbb-mini-p3668.cfg"
TEGRA_FLASHVAR_SCR_CONFIG ?= "tegra194-mb1-bct-scr-cbb-mini-p3668.cfg"
```

## conf/machine/jetson-agx-orin-devkit-industrial.conf
```bitbake
#@TYPE: Machine
#@NAME: Nvidia Jetson AGX Orin Industrial 64GB (P3701-0008)
#@DESCRIPTION: Nvidia Jetson AGX Orin Industrial 64GB module in P3737 carrier

require conf/machine/include/tegra234.inc
require conf/machine/include/devkit-wifi.inc

# Extracted from jetson_board_spec.cfg for BOARDID=3701 and board=jetson-agx-orin-devkit-industrial
TEGRA_BUPGEN_SPECS ?= "fab=300;boardsku=0008;boardrev=;chipsku=00:00:00:90;bup_type=bl \
                       fab=300;boardsku=0008;boardrev=;bup_type=kernel"
KERNEL_DEVICETREE ?= "tegra234-p3701-0008-p3737-0000.dtb"
KERNEL_ARGS ?= "mminit_loglevel=4 console=tty0 console=ttyTCU0,115200 firmware_class.path=/etc/firmware fbcon=map:0 net.ifnames=0"

EMMC_SIZE ?= "63652757504"
EMMC_DEVSECT_SIZE ?= "512"
BOOTPART_SIZE ?= "8388608"
BOOTPART_LIMIT ?= "10485760"
ROOTFSPART_SIZE_DEFAULT ?= "59055800320"
ODMDATA ?= "gbe-uphy-config-22,hsstp-lane-map-3,nvhs-uphy-config-0,hsio-uphy-config-0,gbe0-enable-10g"
EMMC_BCT ?= "tegra234-p3701-0008-sdram-l4t.dts"
NVIDIA_BOARD ?= "t186ref"
PARTITION_LAYOUT_TEMPLATE_DEFAULT ?= "flash_t234_qspi_sdmmc_industrial.xml"
TEGRA_AUDIO_DEVICE ?= "tegra-ape"

OTABOOTDEV ?= "/dev/mtdblock0"
OTAGPTDEV ?= "/dev/mtdblock0"

TEGRA_PLUGIN_MANAGER_OVERLAYS ?= "tegra234-p3737-camera-dual-imx274-overlay.dtbo tegra234-p3737-camera-e3331-overlay.dtbo tegra234-p3737-camera-e3333-overlay.dtbo tegra234-p3737-camera-imx185-overlay.dtbo tegra234-p3737-camera-imx390-overlay.dtbo tegra234-p3737-audio-codec-rt5658-40pin.dtbo tegra234-p3737-overlay.dtbo"
```

## conf/machine/jetson-agx-orin-devkit.conf
```bitbake
#@TYPE: Machine
#@NAME: Nvidia Jetson AGX Orin dev kit
#@DESCRIPTION: Nvidia Jetson AGX Orin dev kit (P3701-0000 module in P3737-0000 carrier)

TEGRA_BUPGEN_SPECS ?= "fab=300;boardsku=0000;boardrev=;chipsku=00:00:00:D0;bup_type=bl \
                       fab=300;boardsku=0000;boardrev=;bup_type=kernel"
KERNEL_DEVICETREE ?= "tegra234-p3737-0000+p3701-0000-nv.dtb"

require conf/machine/include/agx-orin.inc
require conf/machine/include/devkit-wifi.inc
```

## conf/machine/jetson-agx-xavier-devkit.conf
```bitbake
#@TYPE: Machine
#@NAME: Nvidia Jetson Xavier
#@DESCRIPTION: Nvidia Jetson Xavier dev board

require conf/machine/include/agx-xavier.inc

# Extracted from jetson_board_spec.cfg for BOARDID=2888 and board=jetson-agx-xavier-devkit
TEGRA_BUPGEN_SPECS ?= "fab=400;boardsku=0001;boardrev=D.0 \
                       fab=400;boardsku=0001;boardrev=E.0 \
                       fab=400;boardsku=0004;boardrev= \
		       fab=402;boardsku=0005;boardrev="

KERNEL_DEVICETREE ?= "tegra194-p2888-0001-p2822-0000.dtb"

EMMC_BCT ?= "tegra194-mb1-bct-memcfg-p2888.cfg"

PARTITION_LAYOUT_TEMPLATE_DEFAULT ?= "flash_t194_sdmmc.xml"
BOOT_PARTITIONS_ON_EMMC = "1"
TEGRA_PLUGIN_MANAGER_OVERLAYS ?= "tegra194-p2822-camera-dual-imx274-overlay.dtbo tegra194-p2822-camera-e3326-overlay.dtbo tegra194-p2822-camera-e3331-overlay.dtbo tegra194-p2822-camera-e3333-overlay.dtbo tegra194-p2822-camera-imx185-overlay.dtbo tegra194-p2822-camera-imx390-overlay.dtbo tegra194-p2888-0005-overlay.dtbo tegra194-p2888-0001-p2822-0000-overlay.dtbo"

TEGRA_FLASHVAR_BPFDTB_FILE ?= "tegra194-a0@CHIPREV@-bpmp-p2888-@BPFDTBREV@_lz4.dtb"
TEGRA_FLASHVAR_BR_CMD_CONFIG ?= "tegra194-mb1-bct-reset-p2888-0000-p2822-0000.cfg"
TEGRA_FLASHVAR_DEVICE_CONFIG ?= "tegra19x-mb1-bct-device-sdmmc.cfg"
TEGRA_FLASHVAR_DEV_PARAMS ?= "tegra194-br-bct-sdmmc.cfg"
TEGRA_FLASHVAR_DEV_PARAMS_B ?= "tegra194-br-bct_b-sdmmc.cfg"
TEGRA_FLASHVAR_GPIOINT_CONFIG ?= "tegra194-mb1-bct-gpioint-p2888-0000-p2822-0000.cfg"
TEGRA_FLASHVAR_MINRATCHET_CONFIG ?= "--minratchet_config tegra194-mb1-bct-ratchet-p2888-0000-p2822-0000.cfg"
TEGRA_FLASHVAR_MISC_COLD_BOOT_CONFIG ?= "tegra194-mb1-bct-misc-l4t.cfg"
TEGRA_FLASHVAR_MISC_CONFIG ?= "tegra194-mb1-bct-misc-flash.cfg"
TEGRA_FLASHVAR_PINMUX_CONFIG ?= "tegra19x-mb1-pinmux-p2888-0000-a04-p2822-0000-b01.cfg"
TEGRA_FLASHVAR_PMC_CONFIG ?= "tegra19x-mb1-padvoltage-p2888-0000-a00-p2822-0000-a00.cfg"
TEGRA_FLASHVAR_PMIC_CONFIG ?= "tegra194-mb1-bct-pmic-p2888-0001-@PMICREV@-p2822-0000.cfg"
TEGRA_FLASHVAR_PROD_CONFIG ?= "tegra19x-mb1-prod-p2888-0000-p2822-0000.cfg"
TEGRA_FLASHVAR_SCR_COLD_BOOT_CONFIG ?= "tegra194-mb1-bct-scr-cbb-mini.cfg"
TEGRA_FLASHVAR_SCR_CONFIG ?= "tegra194-mb1-bct-scr-cbb-mini.cfg"
TEGRA_FLASHVAR_UPHY_CONFIG ?= "--uphy_config tegra194-mb1-uphy-lane-p2888-0000-p2822-0000.cfg"
```
